AUTOSAR XML (schema 4-1-2)
package /ActiveEcuC
  ecuc value collection ActiveEcuC: ecu-extract=SYSTEM, ecuc-values=[CanSM, EcuC, Det, CanIf, Nm, PduR, Com, Can, Rte, EcuM, CanNm, ComM, Mcu, Os, Crc, Fee, Fls, MemIf, NvM, BswM, Dem]
  module config CanSM: implementation-config-variant=VARIANT-PRE-COMPILE, module-description=CanSM_Impl
    CanSMGeneral:
      CanSMDevErrorDetect = true
      CanSMMainFunctionTimePeriod = 0.01
      CanSMVersionInfoApi = false
      CanSMBorCheckLevel = false
      CanSMSetBaudrateApi = false
      CanSmChangeBaudrateApi = false
      CanSMGeneration: CanSMOutOfBoundsWriteSanitizer=false, CanSMOutOfBoundsReadSanitizer=false
    CanSMConfiguration: CanSMModeRequestRepetitionMax=10, CanSMModeRequestRepetitionTime=0.1
      CHNL_f276589c (CanSMManagerNetwork):
        CanSMBorCounterL1ToL2 = 5
        CanSMBorTimeL1 = 1
        CanSMBorTimeL2 = 3
        CanSMBorTimeTxEnsured = 5
        CanSMBorTxConfirmationPolling = false
        CanSMComMNetworkHandleRef = CAN00_f26020e5
        CT_CAN00_e98c47e6 (CanSMController): CanSMControllerId=CanIfCtrlDrvCfg/CT_CAN00_e98c47e6
  module config EcuC: implementation-config-variant=VARIANT-PRE-COMPILE, module-description=EcuC_Impl
    EcucPduCollection: PduIdTypeEnum=UINT8, PduLengthTypeEnum=UINT8
      8 x Pdu, all with J1939Requestable=false:
        msg_Transmit_ca20852c: PduLength=1, SysTPduToFrameMappingRef=msg_Transmit
        msg_nm_RearECU_721237f7: PduLength=8, SysTPduToFrameMappingRef=msg_nm_RearECU
        msg_nm_MyECU_5fb848b3: PduLength=8, SysTPduToFrameMappingRef=msg_nm_MyECU
        msg_Receive_ff2f8fca: PduLength=1, SysTPduToFrameMappingRef=msg_Receive
        PT_msg_diag_Request_MyECU_PP_msg_diag_Request_MyECU_Rx_0fb271d2_5e566ad9: PduLength=8
        PT_msg_diag_Response_MyECU_PP_msg_diag_Response_MyECU_Tx_0fb271d2_5e566ad9: PduLength=8
        CAN00_NmRxPdu_f26020e5: PduLength=8
        PT_msg_diag_RequestGlobal_PP_msg_diag_RequestGlobal_Rx_0fb271d2_5e566ad9: PduLength=7
    EcucGeneral:
      CPUType = CPU32Bit
      SizeOfInt = Size32Bit
      ByteOrder = LITTLE_ENDIAN
      BitOrder = LSB_to_MSB
      AtomicBitAccessInBitfield = false
      AtomicVariableAccess = Atomic16BitAccess
      SizeOfEnum = Size16Bit
      SizeOfROMPointer = Size32Bit
      SizeOfRAMPointer = Size32Bit
      BitFieldDataType = INT
      StructAlignment = Auto
      ArrayAlignment = Auto
      StructInArrayAlignment = Auto
      DummyFunction = false
      DummyStatement = false
      ConditionalGenerating = true
      DummyStatementKind = SelfAssignment
      EcuCSafeBswChecks = false
      EcuCUseStdReturnTypeForRte = false
      EcucBswImplementationCodeType = EcuCSourceCode
      PostbuildLoadable: AlignmentFillPattern=0, PBRAMEndAddress=0, PBRAMStartAddress=0, PBROMEndAddress=0, PBROMStartAddress=0
      BswInitialization
        26 x InitFunction:
          BswM_Init: Header=BswM.h, InitPhase=NO_INIT, ConfigType=BswM_ConfigType, ConfigPtrName=BswM_Config_Ptr, ConfigPtrClass=BSWM_INIT_DATA, ModuleRef=BswM
          BswM_InitMemory: Header=BswM.h, InitPhase=INIT_MEMORY, ModuleRef=BswM
          CanIf_InitMemory: Header=CanIf.h, InitPhase=INIT_MEMORY, ModuleRef=CanIf
          CanIf_Init: Header=CanIf.h, InitPhase=INIT_TWO_IF, ConfigType=CanIf_ConfigType, ConfigPtrName=CanIf_Config_Ptr, ConfigPtrClass=CANIF_INIT_DATA, ModuleRef=CanIf
          CanNm_InitMemory: Header=CanNm.h, InitPhase=INIT_MEMORY, ModuleRef=CanNm
          CanNm_Init: Header=CanNm.h, InitPhase=INIT_TWO_NM, ConfigType=CanNm_ConfigType, ConfigPtrName=CanNm_Config_Ptr, ConfigPtrClass=CANNM_INIT_DATA, ModuleRef=CanNm
          CanSM_InitMemory: Header=CanSM_EcuM.h, InitPhase=INIT_MEMORY, ModuleRef=CanSM
          CanSM_Init: Header=CanSM_EcuM.h, InitPhase=INIT_TWO_SM, ConfigType=CanSM_ConfigType, ConfigPtrName=CanSM_Config_Ptr, ConfigPtrClass=CANSM_INIT_DATA, ModuleRef=CanSM
          ComM_InitMemory: Header=ComM.h, InitPhase=INIT_MEMORY, ModuleRef=ComM
          ComM_Init: Header=ComM.h, InitPhase=INIT_TWO_POST_NVMREADALL, ModuleRef=ComM
          Com_Init: Header=Com.h, InitPhase=INIT_TWO_COM, ConfigType=Com_ConfigType, ConfigPtrName=Com_Config_Ptr, ConfigPtrClass=COM_INIT_DATA, ModuleRef=Com
          Com_InitMemory: Header=Com.h, InitPhase=INIT_MEMORY, ModuleRef=Com
          Dem_PreInit: Header=Dem.h, InitPhase=INIT_ZERO, ConfigType=Dem_ConfigType, ConfigPtrName=Dem_Config_Ptr, ConfigPtrClass=DEM_INIT_DATA, ModuleRef=Dem
          Dem_InitMemory: Header=Dem.h, InitPhase=INIT_MEMORY, ModuleRef=Dem
          Dem_Init: Header=Dem.h, InitPhase=INIT_TWO_POST_NVMREADALL, ConfigType=Dem_ConfigType, ConfigPtrName=Dem_Config_Ptr, ConfigPtrClass=DEM_INIT_DATA, ModuleRef=Dem
          Det_Init: Header=Det.h, InitPhase=INIT_ZERO, ModuleRef=Det
          Det_InitMemory: Header=Det.h, InitPhase=INIT_MEMORY, ModuleRef=Det
          EcuM_Init: Header=EcuM.h, InitPhase=NO_INIT, ConfigType=EcuM_PbConfigType, ConfigPtrName=EcuM_Config_Ptr, ConfigPtrClass=ECUM_INIT_DATA, ModuleRef=EcuM
          Fee_Init: Header=Fee.h, InitPhase=INIT_TWO_IF, ModuleRef=Fee
          Nm_InitMemory: Header=Nm.h, InitPhase=INIT_MEMORY, ModuleRef=Nm
          Nm_Init: Header=Nm.h, InitPhase=INIT_TWO_NM, ModuleRef=Nm
          NvM_Init: Header=NvM.h, InitPhase=INIT_TWO_SYS, ModuleRef=NvM
          PduR_InitMemory: Header=PduR.h, InitPhase=INIT_MEMORY, ModuleRef=PduR
          PduR_Init: Header=PduR.h, InitPhase=INIT_TWO_COM, ConfigType=PduR_PBConfigType, ConfigPtrName=PduR_Config_Ptr, ConfigPtrClass=PDUR_INIT_DATA, ModuleRef=PduR
          Rte_InitMemory: Header=Rte_Main.h, InitPhase=INIT_MEMORY, ModuleRef=Rte
          SchM_Init: Header=Rte_Main.h, InitPhase=NO_INIT, ModuleRef=Rte
  module config Det: implementation-config-variant=VARIANT-PRE-COMPILE, module-description=Det_Impl
    DetGeneral:
      DetVersionInfoApi = false
      DetEnableDet = true
      DetExtDebugSupport = false
      DetGlobalFilterSize = 0
      DetBreakFilterSize = 0
      DetLogBufferSize = 0
      DetEntryCallout = false
  module config CanIf: implementation-config-variant=VARIANT-PRE-COMPILE, module-description=CanIf_Impl
    CanIfPrivateCfg:
      CanIfPrivateSoftwareFilterType = LINEAR
      CanIfPrivateDlcCheck = true
      CanIfSupportTTCAN = false
      CanIfTransceiverMapping = false
      CanIfTransceiverHandling = false
      CanIfSupportExtendedIds = false
      CanIfSupportNmOsek = false
      CanIfTxBufferType = NONE
      CanIfOptimizeOneController = true
      CanIfWakeupSupport = true
      CanIfMultipleBasicCANTxObjects = false
      CanIfRxSearchConsiderMsgType = false
      CanIfStaticFdTxBufferSupport = false
      CanIfTxBufferFifoSupport = false
      CanIfDataChecksumRxSupport = false
      CanIfDataChecksumTxSupport = false
    CanIfPublicCfg:
      CanIfPublicPnSupport = false
      CanIfPublicCancelTransmitSupport = false
      CanIfPublicDevErrorDetect = true
      CanIfPublicHandleTypeEnum = UINT8
      CanIfPublicMultipleDrvSupport = false
      CanIfPublicNumberOfCanHwUnits = 1
      CanIfPublicReadRxPduDataApi = false
      CanIfPublicReadRxPduNotifyStatusApi = false
      CanIfPublicReadTxPduNotifyStatusApi = false
      CanIfPublicSetDynamicTxIdApi = false
      CanIfPublicTxBuffering = false
      CanIfPublicTxConfirmPollingSupport = false
      CanIfPublicVersionInfoApi = true
      CanIfPublicWakeupCheckValidSupport = false
      CanIfPnWakeupTxPduFilterSupport = false
      CanIfPnTrcvHandlingSupport = false
      CanIfSetBaudrateApi = false
      CanIfPublicChangeBaudrateSupport = false
      CanIfJ1939DynAddrSupport = DISABLED
    CanIfCtrlDrvCfg: CanIfCtrlDrvTxCancellation=false, CanIfCtrlDrvInitHohConfigRef=CanIfInitHohCfg, CanIfCtrlDrvNameRef=CanGeneral
      CT_CAN00_e98c47e6 (CanIfCtrlCfg): CanIfCtrlId=0, CanIfCtrlWakeupSupport=true, CanIfCtrlJ1939DynAddrSupport=DISABLED, CanIfCtrlCanCtrlRef=CanConfigSet/CT_CAN00_e98c47e6
    CanIfInitCfg: CanIfInitCfgSet=1
      CanIfBufferCfg_Tx_Std_0fb271d2 (CanIfBufferCfg):
        CanIfBufferSize = 0
        CanIfTxBufferHandlingType = NONE
        CanIfTxBufferMappedTxPdus = 2
        CanIfTxBufferMaxPduLength = 8
        CanIfBufferHthRef = CanIfInitHohCfg/CN_CAN00_e98c47e6_Tx_Std
      CanIfInitHohCfg: CanIfInitRefCfgSet=CanConfigSet
        CN_CAN00_e98c47e6_Tx_Std (CanIfHthCfg): CanIfHthCanCtrlIdRef=CanIfCtrlDrvCfg/CT_CAN00_e98c47e6, CanIfHthIdSymRef=CanConfigSet/CN_CAN00_e98c47e6_Tx_Std
        CN_CAN00_e98c47e6_Rx_Std (CanIfHrhCfg): CanIfHrhSoftwareFilter=true, CanIfHrhCanCtrlIdRef=CanIfCtrlDrvCfg/CT_CAN00_e98c47e6, CanIfHrhIdSymRef=CanConfigSet/CN_CAN00_e98c47e6_Rx_Std
      CHNL_f276589c_NMCanIDRange (CanIfRxPduCfg):
        CanIfRxPduCanIdType = STANDARD_CAN
        CanIfRxPduDlc = 8
        CanIfRxPduUserRxIndicationName = CanNm_RxIndication
        CanIfRxPduUserRxIndicationUL = CAN_NM
        CanIfRxPduId = 0
        CanIfRxPduReadData = false
        CanIfRxPduReadNotifyStatus = false
        CanIfRxPduDlcCheck = true
        CanIfRxPduHrhIdRef = CanIfInitHohCfg/CN_CAN00_e98c47e6_Rx_Std
        CanIfRxPduRef = CAN00_NmRxPdu_f26020e5
        CHNL (CanIfRxPduCanIdRange): CanIfRxPduCanIdRangeLowerCanId=1024, CanIfRxPduCanIdRangeUpperCanId=1087
      msg_nm_MyECU_oCAN00_Tx_3abd61be (CanIfTxPduCfg):
        CanIfTxPduCanId = 1024
        CanIfTxPduCanIdType = STANDARD_CAN
        CanIfTxPduDlc = 8
        CanIfTxPduUserTxConfirmationName = CanNm_TxConfirmation
        CanIfTxPduUserTxConfirmationUL = CAN_NM
        CanIfTxPduId = 0
        CanIfTxPduReadNotifyStatus = false
        CanIfTxPduType = STATIC
        CanIfTxPduBufferRef = CanIfBufferCfg_Tx_Std_0fb271d2
        CanIfTxPduRef = msg_nm_MyECU_5fb848b3
      msg_Receive_oCAN00_Rx_3abd61be (CanIfRxPduCfg):
        CanIfRxPduCanId = 528
        CanIfRxPduCanIdType = STANDARD_CAN
        CanIfRxPduDlc = 1
        CanIfRxPduUserRxIndicationName = PduR_CanIfRxIndication
        CanIfRxPduUserRxIndicationUL = PDUR
        CanIfRxPduId = 1
        CanIfRxPduReadData = false
        CanIfRxPduReadNotifyStatus = false
        CanIfRxPduDlcCheck = true
        CanIfRxPduHrhIdRef = CanIfInitHohCfg/CN_CAN00_e98c47e6_Rx_Std
        CanIfRxPduRef = msg_Receive_ff2f8fca
      msg_Transmit_oCAN00_Tx_3abd61be (CanIfTxPduCfg):
        CanIfTxPduCanId = 512
        CanIfTxPduCanIdType = STANDARD_CAN
        CanIfTxPduDlc = 1
        CanIfTxPduUserTxConfirmationName = NULL_PTR
        CanIfTxPduUserTxConfirmationUL = NONE
        CanIfTxPduId = 1
        CanIfTxPduReadNotifyStatus = false
        CanIfTxPduType = STATIC
        CanIfTxPduBufferRef = CanIfBufferCfg_Tx_Std_0fb271d2
        CanIfTxPduRef = msg_Transmit_ca20852c
    CanIfDispatchCfg:
      CanIfDispatchUserCtrlBusOffName = CanSM_ControllerBusOff
      CanIfDispatchUserCtrlBusOffUL = CAN_SM
      CanIfDispatchUserCtrlModeIndicationName = CanSM_ControllerModeIndication
      CanIfDispatchUserCtrlModeIndicationUL = CAN_SM
  module config Nm: implementation-config-variant=VARIANT-PRE-COMPILE, module-description=Nm_Impl
    NmGlobalConfig
      NmGlobalFeatures:
        NmComUserDataSupport = false
        NmCoordinatorSupportEnabled = false
        NmUserDataEnabled = true
        NmBusSynchronizationEnabled = false
        NmCarWakeUpRxEnabled = false
        NmComControlEnabled = false
        NmNodeDetectionEnabled = false
        NmNodeIdEnabled = false
        NmPduRxIndicationEnabled = false
        NmRemoteSleepIndEnabled = false
        NmRepeatMsgIndEnabled = false
        NmStateChangeIndEnabled = true
        NmMacroLayerEnabled = false
        NmCoordinatorSyncSupport = false
        NmRuntimeMeasurementSupport = false
        NmCoordinatorPassiveStartUpForwarding = false
        NmCoordinatorRequestChannelsInBusSleep = false
      NmGlobalConstants: NmNumberOfChannels=1
      NmGlobalProperties: NmCycletimeMainFunction=0.01, NmDevErrorDetect=true, NmVersionInfoApi=false
      NmGeneration:
        NmOutOfBoundsWriteSanitizer = false
        NmOutOfBoundsReadSanitizer = false
        NmShortSymbols = false
        NmInterfacesForDeactivatedData = false
        NmReferringKeysInComments = false
    CAN00_17d0077e (NmChannelConfig):
      NmChannelId = 0
      NmChannelSleepMaster = false
      NmPassiveModeEnabled = false
      NmStateReportEnabled = false
      NmSynchronizingNetwork = false
      NmComMChannelRef = CAN00_f26020e5
      NmBusType
        NmStandardBusNmConfig: NmStandardBusType=NM_BUSNM_CANNM
  module config PduR: implementation-config-variant=VARIANT-PRE-COMPILE, module-description=PduR_Impl
    Com (PduRBswModules):
      PduRCancelReceive = false
      PduRCancelTransmit = false
      PduRChangeParameterRequestApi = false
      PduRCommunicationInterface = true
      PduRLowerModule = false
      PduRTransportProtocol = false
      PduRTriggertransmit = false
      PduRTxConfirmation = false
      PduRUpperModule = true
      PduRUseTag = false
      PduRBswModuleRef = Com
    PduRRoutingTables: PduRConfigurationId=0
      PduRRoutingTable
        Can_PT_msg_Receive_0fb271d2 (PduRRoutingPath): PduRRoutingPathCommunicationType=COMMUNICATION_INTERFACE
          DST_Can_PT_msg_Receive_0fb271d2 (PduRDestPdu):
            PduRDestPduHandleId = 0
            PduRTransmissionConfirmation = false
            PduRDestPduDirection = RECEIVE
            PduRDestPduRoutingType = API_FORWARDING
            PduRDestPduRef = msg_Receive_ff2f8fca
            PduRDestPduPduRBswModulesRef = PduR/Com
          SRC_Can_PT_msg_Receive_0fb271d2 (PduRSrcPdu): PduRSourcePduHandleId=0, PduRSrcPduDirection=RECEIVE, PduRSrcPduRef=msg_Receive_ff2f8fca, PduRSrcPduPduRBswModulesRef=PduR/CanIf
        Can_PT_msg_Transmit_0fb271d2 (PduRRoutingPath): PduRRoutingPathCommunicationType=COMMUNICATION_INTERFACE
          SRC_Can_PT_msg_Transmit_0fb271d2 (PduRSrcPdu): PduRSourcePduHandleId=0, PduRSrcPduDirection=TRANSMIT, PduRSrcPduRef=msg_Transmit_ca20852c, PduRSrcPduPduRBswModulesRef=PduR/Com
          DST_Can_PT_msg_Transmit_0fb271d2 (PduRDestPdu):
            PduRDestPduHandleId = 0
            PduRDestPduDataProvision = PDUR_DIRECT
            PduRTransmissionConfirmation = false
            PduRDestPduDirection = TRANSMIT
            PduRDestPduRoutingType = API_FORWARDING
            PduRDestPduRef = msg_Transmit_ca20852c
            PduRDestPduPduRBswModulesRef = PduR/CanIf
    CanIf (PduRBswModules):
      PduRCancelReceive = false
      PduRCancelTransmit = false
      PduRChangeParameterRequestApi = false
      PduRCommunicationInterface = true
      PduRLowerModule = true
      PduRTransportProtocol = false
      PduRTriggertransmit = false
      PduRTxConfirmation = false
      PduRUpperModule = false
      PduRUseTag = false
      PduRBswModuleRef = CanIf
    PduRGeneral: PduRDevErrorDetect=true, PduRVersionInfoApi=false, PduRMetaDataSupport=false, PduRPduCallback=false
      PduRGeneration:
        PduRReduceDataByStreaming = false
        PduRDeduplicateIndirectedData = true
        PduRReduceConstantData2Define = true
        PduRReduceBoolDataByNegationThreshold = 2
        PduRReduceBoolDataByNumericalRelationThreshold = 2
        PduRReduceBoolDataByNumericalComparisonThreshold = 2
        PduRReduceNumericalDataByArraySubtractionThreshold = 2
        PduRReduceNumericalDataByOffsetThreshold = 2
        PduRBoolDataInArrayOfStructStrategy = BITMASKING
        PduRDataDeduplicationStrategy = WITH_CAST
        PduRNumericalDataTypeMinimizationStrategy = WITH_CAST
        PduRReduceBoolDataByNumericalOperandStrategy = WITH_ANY_VALUE
        PduRInterfacesForDeactivatedData = false
        PduROutOfBoundsReadSanitizer = false
        PduROutOfBoundsWriteProtectionStrategy = NONE
        PduROutOfBoundsWriteSanitizer = false
        PduRReferringKeysInComments = false
        PduRShortSymbols = false
  module config Com: implementation-config-variant=VARIANT-PRE-COMPILE, module-description=Com_Impl
    ComConfig: ComConfigurationId=0, ComRxDeferredNotificationCacheSize=0, ComRxImmediateNotificationCacheSize=0
      msg_Receive_oCAN00_3abd61be (ComIPdu):
        ComIPduDirection = RECEIVE
        ComIPduHandleId = 0
        ComIPduSignalProcessing = DEFERRED
        ComIPduType = NORMAL
        ComIPduCancellationSupport = false
        ComIPduGroupRef = MyECU_oCAN00_Rx_fcef2243
        ComIPduSignalRef = sig_State_RearInteriorLight
        ComIPduSignalRef = sig_State_RearLeftDoor
        ComIPduSignalRef = sig_State_RearRightDoor
        ComPduIdRef = msg_Receive_ff2f8fca
      ComTimeBase: ComRxTimeBase=0.01, ComTxTimeBase=0.01, ComGwTimeBase=0.01
      MyECU_oCAN00_Tx_fcef2243 (ComIPduGroup): ComIPduGroupHandleId=1
      MyECU_oCAN00_Rx_fcef2243 (ComIPduGroup): ComIPduGroupHandleId=0
      msg_Transmit_oCAN00_3abd61be (ComIPdu):
        ComIPduDirection = SEND
        ComIPduHandleId = 0
        ComIPduSignalProcessing = DEFERRED
        ComIPduType = NORMAL
        ComIPduCancellationSupport = false
        ComIPduGroupRef = MyECU_oCAN00_Tx_fcef2243
        ComIPduSignalRef = sig_RearInteriorLight
        ComPduIdRef = msg_Transmit_ca20852c
        ComTxIPdu: ComMinimumDelayTime=0, ComTxIPduUnusedAreasDefault=0
          ComTxModeTrue
            ComTxMode: ComTxModeMode=PERIODIC, ComTxModeTimeOffset=0, ComTxModeTimePeriod=0.1
          ComTxModeFalse
            ComTxMode: ComTxModeMode=PERIODIC, ComTxModeTimeOffset=0, ComTxModeTimePeriod=0.1
      4 x ComSignal, all with ComBitSize=1, ComSignalEndianness=LITTLE_ENDIAN, ComSignalInitValue=0, ComSignalAccess=ACCESS_UNCLEAR:
        sig_RearInteriorLight: ComBitPosition=0, ComHandleId=0, ComSignalType=UINT8, ComTransferProperty=PENDING, ComSystemTemplateSystemSignalRef=sig_RearInteriorLight
        sig_State_RearLeftDoor: ComBitPosition=0, ComHandleId=1, ComSignalType=UINT8, ComTimeout=0, ComSystemTemplateSystemSignalRef=sig_State_RearLeftDoor
        sig_State_RearInteriorLight: ComBitPosition=2, ComHandleId=0, ComSignalType=BOOLEAN, ComTimeout=0, ComSystemTemplateSystemSignalRef=sig_State_RearInteriorLight
        sig_State_RearRightDoor: ComBitPosition=1, ComHandleId=2, ComSignalType=UINT8, ComTimeout=0, ComSystemTemplateSystemSignalRef=sig_State_RearRightDoor
    ComGeneral:
      ComConfigurationUseDet = true
      ComRetryFailedTransmitRequests = false
      ComSupportedIPduGroups = 2
      ComVersionInfoApi = false
      ComAdvancedIPduCallouts = false
      ComDeferredEventCacheSupport = false
      ComDescriptionRoutingCodeGeneration = false
      ComEnableSignalGroupArrayApi = false
      ComMainfunctionTimingDomainSupport = false
      ComMetaDataSupport = false
      ComOptimizedIPduGroupHandling = false
      ComReceiveSignalMacroAPI = false
    ComGeneration:
      ComReduceDataByStreaming = false
      ComDeduplicateIndirectedData = true
      ComReduceConstantData2Define = true
      ComReduceBoolDataByNegationThreshold = 2
      ComReduceBoolDataByNumericalRelationThreshold = 2
      ComReduceBoolDataByNumericalComparisonThreshold = 2
      ComReduceNumericalDataByArraySubtractionThreshold = 2
      ComReduceNumericalDataByOffsetThreshold = 2
      ComBoolDataInArrayOfStructStrategy = BITMASKING
      ComDataDeduplicationStrategy = WITH_CAST
      ComNumericalDataTypeMinimizationStrategy = WITH_CAST
      ComReduceBoolDataByNumericalOperandStrategy = WITH_ANY_VALUE
      ComInterfacesForDeactivatedData = false
      ComOutOfBoundsReadSanitizer = false
      ComOutOfBoundsWriteProtectionStrategy = NONE
      ComOutOfBoundsWriteSanitizer = false
      ComReferringKeysInComments = false
      ComShortSymbols = false
    ComOptimization:
      ComTxCyclicProcessingISRLockThreshold = 1
      ComTxDeadlineMonitoringISRLockThreshold = 1
      ComTxProcessingISRLockThreshold = 1
      ComRxDeadlineMonitoringISRLockThreshold = 1
      ComRxDeferredProcessingISRLockThreshold = 1
      ComGatewayProcessingISRLockThreshold = 1
      ComGatewayDescriptionProcessingISRLockThreshold = 1
      ComIPduGroupISRLockThreshold = 1
  module config Can: implementation-config-variant=VARIANT-PRE-COMPILE, module-description=Can_Impl
    CanConfigSet
      CN_CAN00_e98c47e6_Tx_Std (CanHardwareObject):
        CanHandleType = BASIC
        CanIdValue = 0
        CanIdType = STANDARD
        CanObjectType = TRANSMIT
        CanObjectHwSize = 1
        CanObjectId = 0
        CanHwProcessing = false
        CanObjectHwHandle = 0
        CanMaxDataLen = 8
        CanFdPaddingValue = 0
        CanControllerRef = CanConfigSet/CT_CAN00_e98c47e6
      CT_CAN00_e98c47e6 (CanController):
        CanControllerActivation = true
        CanBusoffProcessing = INTERRUPT
        CanControllerId = 0
        CanRxProcessing = INTERRUPT
        CanControllerBaseAddress = 0
        CanTxProcessing = INTERRUPT
        CanWakeupProcessing = INTERRUPT
        CanWakeupSupport = true
        CanWakeupSourceId = 32
        CanIntcChTxBaseAddress = 0
        CanIntcChErrorBaseAddress = 0
        CanIntcChWakeupBaseAddress = 0
        CanPhysController = CAN0
        CanIntPrio = 3
        CanRxFullCanAllocation = 16
        CanRxBasicCanAllocation = 1
        CanRxFifoProcessCount = 8
        CanControllerDefaultBaudrate = CanControllerBaudrateConfig
        CanCpuClockRef = (unset)
        CanWakeupSourceRef = ECUM_WKSOURCE_CAN
        CanControllerBaudrateConfig:
          CanControllerBaudRate = 500
          CanControllerPropSeg = 9
          CanControllerSeg1 = 3
          CanControllerSeg2 = 3
          CanControllerSyncJumpWidth = 2
          CanControllerBaudRateConfigID = 0
          CanBaudrateClock = 80000
          CanBaudratePrescaler = 10
        CanFilterMask: CanFilterMaskValue=448, CanFilterCodeValue=0, IsLocked=false
      CN_CAN00_e98c47e6_Rx_Std (CanHardwareObject):
        CanHandleType = BASIC
        CanIdValue = 0
        CanIdType = STANDARD
        CanObjectType = RECEIVE
        CanObjectHwSize = 1
        CanObjectId = 1
        CanHwProcessing = false
        CanObjectHwHandle = 1
        CanMaxDataLen = 8
        CanFdPaddingValue = 0
        CanControllerRef = CanConfigSet/CT_CAN00_e98c47e6
        CanFilterMaskRef = CanFilterMask
    CanGeneral:
      CanIndex = 0
      CanHardwareLoopCheck = false
      CanChangeBaudrateApi = false
      CanDevErrorDetection = true
      CanHardwareCancellation = false
      CanIdenticalIdCancellation = false
      CanMainFunctionBusoffPeriod = 0.01
      CanMainFunctionModePeriod = 0.01
      CanMainFunctionWakeupPeriod = 0.01
      CanMultiplexedTransmission = false
      CanSetBaudrateApi = false
      CanTimeoutDuration = 0.01
      CanVersionInfoApi = false
      CanGenericPrecopy = false
      CanSecureTempBuffer = false
      CanRxFullCANSupport = false
      CanTxFullCANSupport = false
      CanRxBasicCANSupport = true
      CanUseNestedCANInterrupts = false
      CanHardwareCancelByAppl = false
      CanIndividualProcessing = false
      CanGenericConfirmation = false
      CanRxQueue = false
      CanSupportMixedID = false
      CanRxQueueSize = 1
      CanMultipleBasicCANObjects = false
      CanHardwareHandleType = UINT16
      CanOptimizeOneController = true
      CanInterruptCategory = CATEGORY2
      CanGetStatus = false
      CanInterruptLock = DRIVER
      CanWakeupSupport = true
      CanRamCheck = None
      CanOverrunNotification = DET
      CanReinitStart = true
      CanGenericPreTransmit = false
      CanFdSupport = NONE
      CanRuntimeMeasurementSupport = false
      CanMultipleBasicCANTxObjects = false
      CanMaxRxDataLen = 8
      CanMaxTxDataLen = 8
      CanUsePeripheralAccessApi = false
      CanMirrorModeSupport = false
      CanNumberOfChannels = 6
      CanNumberOfRules = 384
      CanNumberOfPoolbuffers = 384
      CanNumberOfRxBuffers = 96
      CanNumberOfRxFifos = 8
      CanNumberOfTxBuffers = 16
      CanBaseAddress = 0
      CanIntcRxFifoBaseAddress = 0
      CanIntcGlobalErrorBaseAddress = 0
      CanExternalClockSource = false
      CanCanInterface = RSCAN
      CanInterruptControllerAccess = DRIVER
      CanCounterRef = SystemTimer
      CanMainFunctionRWPeriods
  module config Rte: implementation-config-variant=VARIANT-PRE-COMPILE, module-description=Rte_Impl
    CanSM (RteBswModuleInstance): RteBswImplementationRef=CanSM_Impl, RteBswModuleConfigurationRef=CanSM
      5 x RteBswExclusiveAreaImpl, all with RteExclusiveAreaImplMechanism=ALL_INTERRUPT_BLOCKING:
        CANSM_EXCLUSIVE_AREA_{1..5}: RteBswExclusiveAreaRef=CANSM_EXCLUSIVE_AREA_{1..5}
      CanSM_MainFunctionTimingEvent0 (RteBswEventToTaskMapping):
        RteBswImmediateRestart = false
        RteBswPositionInTask = 1
        RteBswEventRef = CanSM_MainFunctionTimingEvent0
        RteBswMappedToTaskRef = SchM_Task
        RteBswUsedOsEventRef = Rte_Ev_Cyclic2_SchM_Task_0_10ms
        RteBswUsedOsAlarmRef = Rte_Al_TE2_SchM_Task_0_10ms
    RteGeneration:
      RteCalibrationSupport = NONE
      RteCodeVendorId = 30
      RteDevErrorDetect = true
      RteDevErrorDetectUninit = false
      RteGenerationMode = COMPATIBILITY_MODE
      RteIocInteractionReturnValue = RTE_IOC
      RteMeasurementSupport = false
      RteOptimizationMode = RUNTIME
      RteValueRangeCheckEnabled = false
      RteVfbTraceEnabled = false
    Det (RteBswModuleInstance): RteBswImplementationRef=Det_Impl, RteBswModuleConfigurationRef=Det
      DET_EXCLUSIVE_AREA_0 (RteBswExclusiveAreaImpl): RteExclusiveAreaImplMechanism=ALL_INTERRUPT_BLOCKING, RteBswExclusiveAreaRef=DET_EXCLUSIVE_AREA_0
    CanIf (RteBswModuleInstance): RteBswImplementationRef=CanIf_Impl, RteBswModuleConfigurationRef=CanIf
      8 x RteBswExclusiveAreaImpl, all with RteExclusiveAreaImplMechanism=ALL_INTERRUPT_BLOCKING:
        CANIF_EXCLUSIVE_AREA_{0..7}: RteBswExclusiveAreaRef=CANIF_EXCLUSIVE_AREA_{0..7}
    RteBswGeneral: RteSchMVersionInfoApi=false, RteUseComShadowSignalApi=false
    6 x RteBswModuleInstance:
      Nm: RteBswImplementationRef=Nm_Impl, RteBswModuleConfigurationRef=Nm
        NM_EXCLUSIVE_AREA_0 (RteBswExclusiveAreaImpl): RteExclusiveAreaImplMechanism=ALL_INTERRUPT_BLOCKING, RteBswExclusiveAreaRef=NM_EXCLUSIVE_AREA_0
        NM_EXCLUSIVE_AREA_1 (RteBswExclusiveAreaImpl): RteExclusiveAreaImplMechanism=ALL_INTERRUPT_BLOCKING, RteBswExclusiveAreaRef=NM_EXCLUSIVE_AREA_1
      PduR: RteBswImplementationRef=PduR_Impl, RteBswModuleConfigurationRef=PduR
        PDUR_EXCLUSIVE_AREA_0 (RteBswExclusiveAreaImpl): RteExclusiveAreaImplMechanism=ALL_INTERRUPT_BLOCKING, RteBswExclusiveAreaRef=PDUR_EXCLUSIVE_AREA_0
        PDUR_EXCLUSIVE_AREA_1 (RteBswExclusiveAreaImpl): RteExclusiveAreaImplMechanism=ALL_INTERRUPT_BLOCKING, RteBswExclusiveAreaRef=PDUR_EXCLUSIVE_AREA_1
      Com: RteBswImplementationRef=Com_Impl, RteBswModuleConfigurationRef=Com
        Com_MainFunctionRxTimingEvent0 (RteBswEventToTaskMapping):
          RteBswImmediateRestart = false
          RteBswPositionInTask = 5
          RteBswEventRef = Com_MainFunctionRxTimingEvent0
          RteBswMappedToTaskRef = SchM_Task
          RteBswUsedOsEventRef = Rte_Ev_Cyclic2_SchM_Task_0_10ms
          RteBswUsedOsAlarmRef = Rte_Al_TE2_SchM_Task_0_10ms
        Com_MainFunctionTxTimingEvent0 (RteBswEventToTaskMapping):
          RteBswImmediateRestart = false
          RteBswPositionInTask = 6
          RteBswEventRef = Com_MainFunctionTxTimingEvent0
          RteBswMappedToTaskRef = SchM_Task
          RteBswUsedOsEventRef = Rte_Ev_Cyclic2_SchM_Task_0_10ms
          RteBswUsedOsAlarmRef = Rte_Al_TE2_SchM_Task_0_10ms
        3 x RteBswExclusiveAreaImpl, all with RteExclusiveAreaImplMechanism=ALL_INTERRUPT_BLOCKING:
          COM_EXCLUSIVE_AREA_TX: RteBswExclusiveAreaRef=COM_EXCLUSIVE_AREA_TX
          COM_EXCLUSIVE_AREA_RX: RteBswExclusiveAreaRef=COM_EXCLUSIVE_AREA_RX
          COM_EXCLUSIVE_AREA_BOTH: RteBswExclusiveAreaRef=COM_EXCLUSIVE_AREA_BOTH
      EcuM: RteBswImplementationRef=EcuM_Impl, RteBswModuleConfigurationRef=EcuM
        ECUM_EXCLUSIVE_AREA_0 (RteBswExclusiveAreaImpl): RteExclusiveAreaImplMechanism=ALL_INTERRUPT_BLOCKING, RteBswExclusiveAreaRef=ECUM_EXCLUSIVE_AREA_0
        EcuM_MainFunctionTimingEvent0 (RteBswEventToTaskMapping):
          RteBswImmediateRestart = false
          RteBswPositionInTask = 9
          RteBswEventRef = EcuM_MainFunctionTimingEvent0
          RteBswMappedToTaskRef = SchM_Task
          RteBswUsedOsEventRef = Rte_Ev_Cyclic2_SchM_Task_0_10ms
          RteBswUsedOsAlarmRef = Rte_Al_TE2_SchM_Task_0_10ms
        ECUM_EXCLUSIVE_AREA_1 (RteBswExclusiveAreaImpl): RteExclusiveAreaImplMechanism=ALL_INTERRUPT_BLOCKING, RteBswExclusiveAreaRef=ECUM_EXCLUSIVE_AREA_1
        ECUM_EXCLUSIVE_AREA_2 (RteBswExclusiveAreaImpl): RteExclusiveAreaImplMechanism=ALL_INTERRUPT_BLOCKING, RteBswExclusiveAreaRef=ECUM_EXCLUSIVE_AREA_2
      CanNm: RteBswImplementationRef=CanNm_Impl, RteBswModuleConfigurationRef=CanNm
        6 x RteBswExclusiveAreaImpl, all with RteExclusiveAreaImplMechanism=ALL_INTERRUPT_BLOCKING:
          CANNM_EXCLUSIVE_AREA_{0..5}: RteBswExclusiveAreaRef=CANNM_EXCLUSIVE_AREA_{0..5}
        CanNm_MainFunctionTimingEvent0 (RteBswEventToTaskMapping):
          RteBswImmediateRestart = false
          RteBswPositionInTask = 3
          RteBswEventRef = CanNm_MainFunctionTimingEvent0
          RteBswMappedToTaskRef = SchM_Task
          RteBswUsedOsEventRef = Rte_Ev_Cyclic2_SchM_Task_0_10ms
          RteBswUsedOsAlarmRef = Rte_Al_TE2_SchM_Task_0_10ms
      ComM: RteBswImplementationRef=ComM_Impl, RteBswModuleConfigurationRef=ComM
        COMM_EXCLUSIVE_AREA_0 (RteBswExclusiveAreaImpl): RteExclusiveAreaImplMechanism=ALL_INTERRUPT_BLOCKING, RteBswExclusiveAreaRef=COMM_EXCLUSIVE_AREA_0
        COMM_EXCLUSIVE_AREA_1 (RteBswExclusiveAreaImpl): RteExclusiveAreaImplMechanism=ALL_INTERRUPT_BLOCKING, RteBswExclusiveAreaRef=COMM_EXCLUSIVE_AREA_1
        ComM_MainFunction_0TimingEvent0 (RteBswEventToTaskMapping):
          RteBswImmediateRestart = false
          RteBswPositionInTask = 0
          RteBswEventRef = ComM_MainFunction_0TimingEvent0
          RteBswMappedToTaskRef = SchM_Task
          RteBswUsedOsEventRef = Rte_Ev_Cyclic2_SchM_Task_0_20ms
          RteBswUsedOsAlarmRef = Rte_Al_TE2_SchM_Task_0_20ms
    RteInitializationBehavior: RteInitializationStrategy=RTE_INITIALIZATION_STRATEGY_AT_DATA_DECLARATION, RteSectionInitializationPolicy=, RteSectionInitializationPolicy=INIT
    RteOsInteraction
    Fee (RteBswModuleInstance): RteBswImplementationRef=Fee_Impl, RteBswModuleConfigurationRef=Fee
      Fee_MainFunctionTimingEvent0 (RteBswEventToTaskMapping):
        RteBswImmediateRestart = false
        RteBswPositionInTask = 11
        RteBswEventRef = Fee_MainFunctionTimingEvent0
        RteBswMappedToTaskRef = SchM_Task
        RteBswUsedOsEventRef = Rte_Ev_Run_Fee_Fee_MainFunction
        RteBswUsedOsAlarmRef = Rte_Al_TE_Fee_Fee_MainFunction
      FEE_EXCLUSIVE_AREA_0 (RteBswExclusiveAreaImpl): RteExclusiveAreaImplMechanism=ALL_INTERRUPT_BLOCKING, RteBswExclusiveAreaRef=FEE_EXCLUSIVE_AREA_0
    NvM (RteBswModuleInstance): RteBswImplementationRef=NvM_Impl, RteBswModuleConfigurationRef=NvM
      NvM_MainFunctionTimingEvent0 (RteBswEventToTaskMapping):
        RteBswImmediateRestart = false
        RteBswPositionInTask = 13
        RteBswEventRef = NvM_MainFunctionTimingEvent0
        RteBswMappedToTaskRef = SchM_Task
        RteBswUsedOsEventRef = Rte_Ev_Cyclic2_SchM_Task_0_10ms
        RteBswUsedOsAlarmRef = Rte_Al_TE2_SchM_Task_0_10ms
      NVM_EXCLUSIVE_AREA_0 (RteBswExclusiveAreaImpl): RteExclusiveAreaImplMechanism=ALL_INTERRUPT_BLOCKING, RteBswExclusiveAreaRef=NVM_EXCLUSIVE_AREA_0
    4 x RteSwComponentInstance:
      ComM_P_EcuSwComposition: RteSoftwareComponentInstanceRef=ComM_P
        13 x RteEventToTaskMapping, all with RteImmediateRestart=false:
          OpEventLimitECUToNoComMode_LimitECUToNoComMode_modeLimitation: RteEventRef=OpEventLimitECUToNoComMode_LimitECUToNoComMode_modeLimitation
          OpEventReadInhibitCounter_ReadInhibitCounter_modeLimitation: RteEventRef=OpEventReadInhibitCounter_ReadInhibitCounter_modeLimitation
          OpEventResetInhibitCounter_ResetInhibitCounter_modeLimitation: RteEventRef=OpEventResetInhibitCounter_ResetInhibitCounter_modeLimitation
          OpEventSetECUGroupClassification_SetECUGroupClassification_modeLimitation: RteEventRef=OpEventSetECUGroupClassification_SetECUGroupClassification_modeLimitation
          Timer_ComM_MainFunction_0: RtePositionInTask=0, RteEventRef=Timer_ComM_MainFunction_0, RteMappedToTaskRef=SchM_Task
          OpEventLimitChannelToNoComMode_LimitChannelToNoComMode_CL_CAN00_f26020e5: RteEventRef=OpEventLimitChannelToNoComMode_LimitChannelToNoComMode_CL_CAN00_f26020e5
          OpEventGetMaxComMode_GetMaxComMode_UR_USR_CHNL_f276589c: RteEventRef=OpEventGetMaxComMode_GetMaxComMode_UR_USR_CHNL_f276589c
          OpEventGetCurrentComMode_GetCurrentComMode_UR_USR_CHNL_f276589c: RteEventRef=OpEventGetCurrentComMode_GetCurrentComMode_UR_USR_CHNL_f276589c
          OpEventGetInhibitionStatus_GetInhibitionStatus_CW_CAN00_f26020e5: RteEventRef=OpEventGetInhibitionStatus_GetInhibitionStatus_CW_CAN00_f26020e5
          OpEventGetInhibitionStatus_GetInhibitionStatus_CL_CAN00_f26020e5: RteEventRef=OpEventGetInhibitionStatus_GetInhibitionStatus_CL_CAN00_f26020e5
          OpEventRequestComMode_RequestComMode_UR_USR_CHNL_f276589c: RteEventRef=OpEventRequestComMode_RequestComMode_UR_USR_CHNL_f276589c
          OpEventPreventWakeUp_PreventWakeUp_CW_CAN00_f26020e5: RteEventRef=OpEventPreventWakeUp_PreventWakeUp_CW_CAN00_f26020e5
          OpEventGetRequestedComMode_GetRequestedComMode_UR_USR_CHNL_f276589c: RteEventRef=OpEventGetRequestedComMode_GetRequestedComMode_UR_USR_CHNL_f276589c
      Det_P_EcuSwComposition: RteSoftwareComponentInstanceRef=Det_P
      EcuM_P_EcuSwComposition: RteSoftwareComponentInstanceRef=EcuM_P
        8 x RteEventToTaskMapping, all with RteImmediateRestart=false:
          OpEventSelectShutdownTarget_SelectShutdownTarget_EcuM_ShutdownTarget: RteEventRef=OpEventSelectShutdownTarget_SelectShutdownTarget_EcuM_ShutdownTarget
          OpEventGetShutdownTarget_GetShutdownTarget_EcuM_ShutdownTarget: RteEventRef=OpEventGetShutdownTarget_GetShutdownTarget_EcuM_ShutdownTarget
          OpEventGetLastShutdownTarget_GetLastShutdownTarget_EcuM_ShutdownTarget: RteEventRef=OpEventGetLastShutdownTarget_GetLastShutdownTarget_EcuM_ShutdownTarget
          OpEventSelectShutdownCause_SelectShutdownCause_EcuM_ShutdownTarget: RteEventRef=OpEventSelectShutdownCause_SelectShutdownCause_EcuM_ShutdownTarget
          OpEventGetShutdownCause_GetShutdownCause_EcuM_ShutdownTarget: RteEventRef=OpEventGetShutdownCause_GetShutdownCause_EcuM_ShutdownTarget
          OpEventSelectBootTarget_SelectBootTarget_EcuM_BootTarget: RteEventRef=OpEventSelectBootTarget_SelectBootTarget_EcuM_BootTarget
          OpEventGetBootTarget_GetBootTarget_EcuM_BootTarget: RteEventRef=OpEventGetBootTarget_GetBootTarget_EcuM_BootTarget
          Timer_EcuM_MainFunction: RtePositionInTask=9, RteEventRef=Timer_EcuM_MainFunction, RteMappedToTaskRef=SchM_Task
      NvM_P_EcuSwComposition: RteSoftwareComponentInstanceRef=NvM_P
        8 x RteEventToTaskMapping, all with RteImmediateRestart=false:
          Timer_NvM_MainFunction: RtePositionInTask=13, RteEventRef=Timer_NvM_MainFunction, RteMappedToTaskRef=SchM_Task, RteUsedOsEventRef=Rte_Ev_Cyclic2_SchM_Task_0_10ms, RteUsedOsAlarmRef=Rte_Al_TE2_SchM_Task_0_10ms
          OpEventEraseBlock_EraseBlock_PS_NvMConfigBlock: RteEventRef=OpEventEraseBlock_EraseBlock_PS_NvMConfigBlock
          OpEventWriteBlock_WriteBlock_PS_NvMConfigBlock: RteEventRef=OpEventWriteBlock_WriteBlock_PS_NvMConfigBlock
          OpEventSetBlockProtection_SetBlockProtection_PAdmin_NvMConfigBlock: RteEventRef=OpEventSetBlockProtection_SetBlockProtection_PAdmin_NvMConfigBlock
          OpEventSetRamBlockStatus_SetRamBlockStatus_PS_NvMConfigBlock: RteEventRef=OpEventSetRamBlockStatus_SetRamBlockStatus_PS_NvMConfigBlock
          OpEventInvalidateNvBlock_InvalidateNvBlock_PS_NvMConfigBlock: RteEventRef=OpEventInvalidateNvBlock_InvalidateNvBlock_PS_NvMConfigBlock
          OpEventReadBlock_ReadBlock_PS_NvMConfigBlock: RteEventRef=OpEventReadBlock_ReadBlock_PS_NvMConfigBlock
          OpEventGetErrorStatus_GetErrorStatus_PS_NvMConfigBlock: RteEventRef=OpEventGetErrorStatus_GetErrorStatus_PS_NvMConfigBlock
    BswM (RteBswModuleInstance): RteBswImplementationRef=BswM_Impl, RteBswModuleConfigurationRef=BswM
      BswM_MainFunctionTimingEvent0 (RteBswEventToTaskMapping):
        RteBswImmediateRestart = false
        RteBswPositionInTask = 25
        RteBswEventRef = BswM_MainFunctionTimingEvent0
        RteBswMappedToTaskRef = SchM_Task
        RteBswUsedOsEventRef = Rte_Ev_Cyclic2_SchM_Task_0_10ms
        RteBswUsedOsAlarmRef = Rte_Al_TE2_SchM_Task_0_10ms
      BSWM_EXCLUSIVE_AREA_0 (RteBswExclusiveAreaImpl): RteExclusiveAreaImplMechanism=ALL_INTERRUPT_BLOCKING, RteBswExclusiveAreaRef=BSWM_EXCLUSIVE_AREA_0
    Dem (RteBswModuleInstance): RteBswImplementationRef=Dem_Impl, RteBswModuleConfigurationRef=Dem
      Dem_MainFunctionTimingEvent0 (RteBswEventToTaskMapping):
        RteBswImmediateRestart = false
        RteBswPositionInTask = 8
        RteBswEventRef = Dem_MainFunctionTimingEvent0
        RteBswMappedToTaskRef = SchM_Task
        RteBswUsedOsEventRef = Rte_Ev_Cyclic2_SchM_Task_0_10ms
        RteBswUsedOsAlarmRef = Rte_Al_TE2_SchM_Task_0_10ms
      3 x RteBswExclusiveAreaImpl, all with RteExclusiveAreaImplMechanism=ALL_INTERRUPT_BLOCKING:
        DEM_EXCLUSIVE_AREA_{0..2}: RteBswExclusiveAreaRef=DEM_EXCLUSIVE_AREA_{0..2}
    Dem_P_EcuSwComposition (RteSwComponentInstance): RteSoftwareComponentInstanceRef=Dem_P
      103 x RteEventToTaskMapping, all with RteImmediateRestart=false:
        Timer_Dem_MainFunction: RtePositionInTask=8, RteEventRef=Timer_Dem_MainFunction, RteMappedToTaskRef=SchM_Task, RteUsedOsEventRef=Rte_Ev_Cyclic2_SchM_Task_0_10ms, RteUsedOsAlarmRef=Rte_Al_TE2_SchM_Task_0_10ms
        OpEventGetDTCStatusAvailabilityMask_GetDTCStatusAvailabilityMask_DemServices: RteEventRef=OpEventGetDTCStatusAvailabilityMask_GetDTCStatusAvailabilityMask_DemServices
        OpEventGetEventMemoryOverflow_GetEventMemoryOverflow_OverflowIndPrimaryMemory: RteEventRef=OpEventGetEventMemoryOverflow_GetEventMemoryOverflow_OverflowIndPrimaryMemory
        OpEventGetEventTested_GetEventTested_EvtInfo_AutoCreatedDemEvent_ECUM_E_CONFIGURATION_DATA_INCONSISTENT: RteEventRef=OpEventGetEventTested_GetEventTested_EvtInfo_AutoCreatedDemEvent_ECUM_E_CONFIGURATION_DATA_INCONSISTENT
        OpEventGetDTCOfEvent_GetDTCOfEvent_GeneralEventInfo: RteEventRef=OpEventGetDTCOfEvent_GetDTCOfEvent_GeneralEventInfo
        OpEventGetEventEnableCondition_GetEventEnableCondition_EvtInfo_AutoCreatedDemEvent_ECUM_E_CONFIGURATION_DATA_INCONSISTENT: RteEventRef=OpEventGetEventEnableCondition_GetEventEnableCondition_EvtInfo_AutoCreatedDemEvent_ECUM_E_CONFIGURATION_DATA_INCONSISTENT
        OpEventGetEventEnableCondition_GetEventEnableCondition_GeneralEventInfo: RteEventRef=OpEventGetEventEnableCondition_GetEventEnableCondition_GeneralEventInfo
        OpEventGetDTCOfEvent_GetDTCOfEvent_EvtInfo_AutoCreatedDemEvent_ECUM_E_CONFIGURATION_DATA_INCONSISTENT: RteEventRef=OpEventGetDTCOfEvent_GetDTCOfEvent_EvtInfo_AutoCreatedDemEvent_ECUM_E_CONFIGURATION_DATA_INCONSISTENT
        OpEventGetEventTested_GetEventTested_GeneralEventInfo: RteEventRef=OpEventGetEventTested_GetEventTested_GeneralEventInfo
        OpEventGetEventStatus_GetEventStatus_EvtInfo_AutoCreatedDemEvent_ECUM_E_CONFIGURATION_DATA_INCONSISTENT: RteEventRef=OpEventGetEventStatus_GetEventStatus_EvtInfo_AutoCreatedDemEvent_ECUM_E_CONFIGURATION_DATA_INCONSISTENT
        OpEventGetEventStatus_GetEventStatus_GeneralEventInfo: RteEventRef=OpEventGetEventStatus_GetEventStatus_GeneralEventInfo
        OpEventGetEventFailed_GetEventFailed_GeneralEventInfo: RteEventRef=OpEventGetEventFailed_GetEventFailed_GeneralEventInfo
        OpEventGetEventFailed_GetEventFailed_EvtInfo_AutoCreatedDemEvent_ECUM_E_CONFIGURATION_DATA_INCONSISTENT: RteEventRef=OpEventGetEventFailed_GetEventFailed_EvtInfo_AutoCreatedDemEvent_ECUM_E_CONFIGURATION_DATA_INCONSISTENT
        OpEventGetEventExtendedDataRecord_GetEventExtendedDataRecord_EvtInfo_AutoCreatedDemEvent_ECUM_E_CONFIGURATION_DATA_INCONSISTENT: RteEventRef=OpEventGetEventExtendedDataRecord_GetEventExtendedDataRecord_EvtInfo_AutoCreatedDemEvent_ECUM_E_CONFIGURATION_DATA_INCONSISTENT
        OpEventGetEventExtendedDataRecord_GetEventExtendedDataRecord_GeneralEventInfo: RteEventRef=OpEventGetEventExtendedDataRecord_GetEventExtendedDataRecord_GeneralEventInfo
        OpEventGetFaultDetectionCounter_GetFaultDetectionCounter_EvtInfo_AutoCreatedDemEvent_ECUM_E_CONFIGURATION_DATA_INCONSISTENT: RteEventRef=OpEventGetFaultDetectionCounter_GetFaultDetectionCounter_EvtInfo_AutoCreatedDemEvent_ECUM_E_CONFIGURATION_DATA_INCONSISTENT
        OpEventGetEventFreezeFrameData_GetEventFreezeFrameData_EvtInfo_AutoCreatedDemEvent_ECUM_E_CONFIGURATION_DATA_INCONSISTENT: RteEventRef=OpEventGetEventFreezeFrameData_GetEventFreezeFrameData_EvtInfo_AutoCreatedDemEvent_ECUM_E_CONFIGURATION_DATA_INCONSISTENT
        OpEventGetEventFreezeFrameData_GetEventFreezeFrameData_GeneralEventInfo: RteEventRef=OpEventGetEventFreezeFrameData_GetEventFreezeFrameData_GeneralEventInfo
        OpEventGetFaultDetectionCounter_GetFaultDetectionCounter_GeneralEventInfo: RteEventRef=OpEventGetFaultDetectionCounter_GetFaultDetectionCounter_GeneralEventInfo
        OpEventGetEventEnableCondition_GetEventEnableCondition_EvtInfo_AutoCreatedDemEvent_ECUM_E_RAM_CHECK_FAILED: RteEventRef=OpEventGetEventEnableCondition_GetEventEnableCondition_EvtInfo_AutoCreatedDemEvent_ECUM_E_RAM_CHECK_FAILED
        OpEventGetFaultDetectionCounter_GetFaultDetectionCounter_EvtInfo_AutoCreatedDemEvent_ECUM_E_RAM_CHECK_FAILED: RteEventRef=OpEventGetFaultDetectionCounter_GetFaultDetectionCounter_EvtInfo_AutoCreatedDemEvent_ECUM_E_RAM_CHECK_FAILED
        OpEventGetEventFailed_GetEventFailed_EvtInfo_AutoCreatedDemEvent_ECUM_E_RAM_CHECK_FAILED: RteEventRef=OpEventGetEventFailed_GetEventFailed_EvtInfo_AutoCreatedDemEvent_ECUM_E_RAM_CHECK_FAILED
        OpEventGetEventStatus_GetEventStatus_EvtInfo_AutoCreatedDemEvent_ECUM_E_RAM_CHECK_FAILED: RteEventRef=OpEventGetEventStatus_GetEventStatus_EvtInfo_AutoCreatedDemEvent_ECUM_E_RAM_CHECK_FAILED
        OpEventGetDTCOfEvent_GetDTCOfEvent_EvtInfo_AutoCreatedDemEvent_ECUM_E_RAM_CHECK_FAILED: RteEventRef=OpEventGetDTCOfEvent_GetDTCOfEvent_EvtInfo_AutoCreatedDemEvent_ECUM_E_RAM_CHECK_FAILED
        OpEventGetEventExtendedDataRecord_GetEventExtendedDataRecord_EvtInfo_AutoCreatedDemEvent_ECUM_E_RAM_CHECK_FAILED: RteEventRef=OpEventGetEventExtendedDataRecord_GetEventExtendedDataRecord_EvtInfo_AutoCreatedDemEvent_ECUM_E_RAM_CHECK_FAILED
        OpEventGetEventTested_GetEventTested_EvtInfo_AutoCreatedDemEvent_ECUM_E_RAM_CHECK_FAILED: RteEventRef=OpEventGetEventTested_GetEventTested_EvtInfo_AutoCreatedDemEvent_ECUM_E_RAM_CHECK_FAILED
        OpEventGetEventFreezeFrameData_GetEventFreezeFrameData_EvtInfo_AutoCreatedDemEvent_ECUM_E_RAM_CHECK_FAILED: RteEventRef=OpEventGetEventFreezeFrameData_GetEventFreezeFrameData_EvtInfo_AutoCreatedDemEvent_ECUM_E_RAM_CHECK_FAILED
        OpEventGetFaultDetectionCounter_GetFaultDetectionCounter_EvtInfo_AutoCreatedDemEvent_NVM_E_INTEGRITY_FAILED: RteEventRef=OpEventGetFaultDetectionCounter_GetFaultDetectionCounter_EvtInfo_AutoCreatedDemEvent_NVM_E_INTEGRITY_FAILED
        OpEventGetEventStatus_GetEventStatus_EvtInfo_AutoCreatedDemEvent_NVM_E_INTEGRITY_FAILED: RteEventRef=OpEventGetEventStatus_GetEventStatus_EvtInfo_AutoCreatedDemEvent_NVM_E_INTEGRITY_FAILED
        OpEventGetEventEnableCondition_GetEventEnableCondition_EvtInfo_AutoCreatedDemEvent_NVM_E_INTEGRITY_FAILED: RteEventRef=OpEventGetEventEnableCondition_GetEventEnableCondition_EvtInfo_AutoCreatedDemEvent_NVM_E_INTEGRITY_FAILED
        OpEventGetEventFreezeFrameData_GetEventFreezeFrameData_EvtInfo_AutoCreatedDemEvent_NVM_E_INTEGRITY_FAILED: RteEventRef=OpEventGetEventFreezeFrameData_GetEventFreezeFrameData_EvtInfo_AutoCreatedDemEvent_NVM_E_INTEGRITY_FAILED
        OpEventGetDTCOfEvent_GetDTCOfEvent_EvtInfo_AutoCreatedDemEvent_NVM_E_INTEGRITY_FAILED: RteEventRef=OpEventGetDTCOfEvent_GetDTCOfEvent_EvtInfo_AutoCreatedDemEvent_NVM_E_INTEGRITY_FAILED
        OpEventGetEventExtendedDataRecord_GetEventExtendedDataRecord_EvtInfo_AutoCreatedDemEvent_NVM_E_INTEGRITY_FAILED: RteEventRef=OpEventGetEventExtendedDataRecord_GetEventExtendedDataRecord_EvtInfo_AutoCreatedDemEvent_NVM_E_INTEGRITY_FAILED
        OpEventGetEventFailed_GetEventFailed_EvtInfo_AutoCreatedDemEvent_NVM_E_INTEGRITY_FAILED: RteEventRef=OpEventGetEventFailed_GetEventFailed_EvtInfo_AutoCreatedDemEvent_NVM_E_INTEGRITY_FAILED
        OpEventGetEventTested_GetEventTested_EvtInfo_AutoCreatedDemEvent_NVM_E_INTEGRITY_FAILED: RteEventRef=OpEventGetEventTested_GetEventTested_EvtInfo_AutoCreatedDemEvent_NVM_E_INTEGRITY_FAILED
        OpEventGetDTCOfEvent_GetDTCOfEvent_EvtInfo_AutoCreatedDemEvent_NVM_E_LOSS_OF_REDUNDANCY: RteEventRef=OpEventGetDTCOfEvent_GetDTCOfEvent_EvtInfo_AutoCreatedDemEvent_NVM_E_LOSS_OF_REDUNDANCY
        OpEventGetEventFailed_GetEventFailed_EvtInfo_AutoCreatedDemEvent_NVM_E_LOSS_OF_REDUNDANCY: RteEventRef=OpEventGetEventFailed_GetEventFailed_EvtInfo_AutoCreatedDemEvent_NVM_E_LOSS_OF_REDUNDANCY
        OpEventGetEventFreezeFrameData_GetEventFreezeFrameData_EvtInfo_AutoCreatedDemEvent_NVM_E_LOSS_OF_REDUNDANCY: RteEventRef=OpEventGetEventFreezeFrameData_GetEventFreezeFrameData_EvtInfo_AutoCreatedDemEvent_NVM_E_LOSS_OF_REDUNDANCY
        OpEventGetFaultDetectionCounter_GetFaultDetectionCounter_EvtInfo_AutoCreatedDemEvent_NVM_E_LOSS_OF_REDUNDANCY: RteEventRef=OpEventGetFaultDetectionCounter_GetFaultDetectionCounter_EvtInfo_AutoCreatedDemEvent_NVM_E_LOSS_OF_REDUNDANCY
        OpEventGetEventEnableCondition_GetEventEnableCondition_EvtInfo_AutoCreatedDemEvent_NVM_E_LOSS_OF_REDUNDANCY: RteEventRef=OpEventGetEventEnableCondition_GetEventEnableCondition_EvtInfo_AutoCreatedDemEvent_NVM_E_LOSS_OF_REDUNDANCY
        OpEventGetEventExtendedDataRecord_GetEventExtendedDataRecord_EvtInfo_AutoCreatedDemEvent_NVM_E_LOSS_OF_REDUNDANCY: RteEventRef=OpEventGetEventExtendedDataRecord_GetEventExtendedDataRecord_EvtInfo_AutoCreatedDemEvent_NVM_E_LOSS_OF_REDUNDANCY
        OpEventGetEventTested_GetEventTested_EvtInfo_AutoCreatedDemEvent_NVM_E_LOSS_OF_REDUNDANCY: RteEventRef=OpEventGetEventTested_GetEventTested_EvtInfo_AutoCreatedDemEvent_NVM_E_LOSS_OF_REDUNDANCY
        OpEventGetEventStatus_GetEventStatus_EvtInfo_AutoCreatedDemEvent_NVM_E_LOSS_OF_REDUNDANCY: RteEventRef=OpEventGetEventStatus_GetEventStatus_EvtInfo_AutoCreatedDemEvent_NVM_E_LOSS_OF_REDUNDANCY
        OpEventGetEventEnableCondition_GetEventEnableCondition_EvtInfo_AutoCreatedDemEvent_NVM_E_QUEUE_OVERFLOW: RteEventRef=OpEventGetEventEnableCondition_GetEventEnableCondition_EvtInfo_AutoCreatedDemEvent_NVM_E_QUEUE_OVERFLOW
        OpEventGetEventFailed_GetEventFailed_EvtInfo_AutoCreatedDemEvent_NVM_E_QUEUE_OVERFLOW: RteEventRef=OpEventGetEventFailed_GetEventFailed_EvtInfo_AutoCreatedDemEvent_NVM_E_QUEUE_OVERFLOW
        OpEventGetEventFreezeFrameData_GetEventFreezeFrameData_EvtInfo_AutoCreatedDemEvent_NVM_E_QUEUE_OVERFLOW: RteEventRef=OpEventGetEventFreezeFrameData_GetEventFreezeFrameData_EvtInfo_AutoCreatedDemEvent_NVM_E_QUEUE_OVERFLOW
        OpEventGetFaultDetectionCounter_GetFaultDetectionCounter_EvtInfo_AutoCreatedDemEvent_NVM_E_QUEUE_OVERFLOW: RteEventRef=OpEventGetFaultDetectionCounter_GetFaultDetectionCounter_EvtInfo_AutoCreatedDemEvent_NVM_E_QUEUE_OVERFLOW
        OpEventGetEventTested_GetEventTested_EvtInfo_AutoCreatedDemEvent_NVM_E_QUEUE_OVERFLOW: RteEventRef=OpEventGetEventTested_GetEventTested_EvtInfo_AutoCreatedDemEvent_NVM_E_QUEUE_OVERFLOW
        OpEventGetDTCOfEvent_GetDTCOfEvent_EvtInfo_AutoCreatedDemEvent_NVM_E_QUEUE_OVERFLOW: RteEventRef=OpEventGetDTCOfEvent_GetDTCOfEvent_EvtInfo_AutoCreatedDemEvent_NVM_E_QUEUE_OVERFLOW
        OpEventGetEventExtendedDataRecord_GetEventExtendedDataRecord_EvtInfo_AutoCreatedDemEvent_NVM_E_QUEUE_OVERFLOW: RteEventRef=OpEventGetEventExtendedDataRecord_GetEventExtendedDataRecord_EvtInfo_AutoCreatedDemEvent_NVM_E_QUEUE_OVERFLOW
        OpEventGetEventStatus_GetEventStatus_EvtInfo_AutoCreatedDemEvent_NVM_E_QUEUE_OVERFLOW: RteEventRef=OpEventGetEventStatus_GetEventStatus_EvtInfo_AutoCreatedDemEvent_NVM_E_QUEUE_OVERFLOW
        OpEventGetEventTested_GetEventTested_EvtInfo_AutoCreatedDemEvent_NVM_E_WRITE_PROTECTED: RteEventRef=OpEventGetEventTested_GetEventTested_EvtInfo_AutoCreatedDemEvent_NVM_E_WRITE_PROTECTED
        OpEventGetDTCOfEvent_GetDTCOfEvent_EvtInfo_AutoCreatedDemEvent_NVM_E_WRITE_PROTECTED: RteEventRef=OpEventGetDTCOfEvent_GetDTCOfEvent_EvtInfo_AutoCreatedDemEvent_NVM_E_WRITE_PROTECTED
        OpEventGetEventEnableCondition_GetEventEnableCondition_EvtInfo_AutoCreatedDemEvent_NVM_E_VERIFY_FAILED: RteEventRef=OpEventGetEventEnableCondition_GetEventEnableCondition_EvtInfo_AutoCreatedDemEvent_NVM_E_VERIFY_FAILED
        OpEventGetEventStatus_GetEventStatus_EvtInfo_AutoCreatedDemEvent_NVM_E_WRITE_PROTECTED: RteEventRef=OpEventGetEventStatus_GetEventStatus_EvtInfo_AutoCreatedDemEvent_NVM_E_WRITE_PROTECTED
        OpEventGetDTCOfEvent_GetDTCOfEvent_EvtInfo_AutoCreatedDemEvent_NVM_E_WRONG_BLOCK_ID: RteEventRef=OpEventGetDTCOfEvent_GetDTCOfEvent_EvtInfo_AutoCreatedDemEvent_NVM_E_WRONG_BLOCK_ID
        OpEventGetEventFailed_GetEventFailed_EvtInfo_AutoCreatedDemEvent_NVM_E_VERIFY_FAILED: RteEventRef=OpEventGetEventFailed_GetEventFailed_EvtInfo_AutoCreatedDemEvent_NVM_E_VERIFY_FAILED
        OpEventGetEventExtendedDataRecord_GetEventExtendedDataRecord_EvtInfo_AutoCreatedDemEvent_NVM_E_REQ_FAILED: RteEventRef=OpEventGetEventExtendedDataRecord_GetEventExtendedDataRecord_EvtInfo_AutoCreatedDemEvent_NVM_E_REQ_FAILED
        OpEventGetEventEnableCondition_GetEventEnableCondition_EvtInfo_AutoCreatedDemEvent_NVM_E_REQ_FAILED: RteEventRef=OpEventGetEventEnableCondition_GetEventEnableCondition_EvtInfo_AutoCreatedDemEvent_NVM_E_REQ_FAILED
        OpEventGetFaultDetectionCounter_GetFaultDetectionCounter_EvtInfo_AutoCreatedDemEvent_NVM_E_WRITE_PROTECTED: RteEventRef=OpEventGetFaultDetectionCounter_GetFaultDetectionCounter_EvtInfo_AutoCreatedDemEvent_NVM_E_WRITE_PROTECTED
        OpEventGetEventEnableCondition_GetEventEnableCondition_EvtInfo_AutoCreatedDemEvent_NVM_E_WRITE_PROTECTED: RteEventRef=OpEventGetEventEnableCondition_GetEventEnableCondition_EvtInfo_AutoCreatedDemEvent_NVM_E_WRITE_PROTECTED
        OpEventGetFaultDetectionCounter_GetFaultDetectionCounter_EvtInfo_AutoCreatedDemEvent_NVM_E_VERIFY_FAILED: RteEventRef=OpEventGetFaultDetectionCounter_GetFaultDetectionCounter_EvtInfo_AutoCreatedDemEvent_NVM_E_VERIFY_FAILED
        OpEventGetEventExtendedDataRecord_GetEventExtendedDataRecord_EvtInfo_AutoCreatedDemEvent_NVM_E_WRONG_BLOCK_ID: RteEventRef=OpEventGetEventExtendedDataRecord_GetEventExtendedDataRecord_EvtInfo_AutoCreatedDemEvent_NVM_E_WRONG_BLOCK_ID
        OpEventGetEventEnableCondition_GetEventEnableCondition_EvtInfo_AutoCreatedDemEvent_NVM_E_WRONG_BLOCK_ID: RteEventRef=OpEventGetEventEnableCondition_GetEventEnableCondition_EvtInfo_AutoCreatedDemEvent_NVM_E_WRONG_BLOCK_ID
        OpEventGetEventTested_GetEventTested_EvtInfo_AutoCreatedDemEvent_NVM_E_REQ_FAILED: RteEventRef=OpEventGetEventTested_GetEventTested_EvtInfo_AutoCreatedDemEvent_NVM_E_REQ_FAILED
        OpEventGetEventStatus_GetEventStatus_EvtInfo_AutoCreatedDemEvent_NVM_E_VERIFY_FAILED: RteEventRef=OpEventGetEventStatus_GetEventStatus_EvtInfo_AutoCreatedDemEvent_NVM_E_VERIFY_FAILED
        OpEventGetEventStatus_GetEventStatus_EvtInfo_AutoCreatedDemEvent_NVM_E_WRONG_BLOCK_ID: RteEventRef=OpEventGetEventStatus_GetEventStatus_EvtInfo_AutoCreatedDemEvent_NVM_E_WRONG_BLOCK_ID
        OpEventGetDTCOfEvent_GetDTCOfEvent_EvtInfo_AutoCreatedDemEvent_NVM_E_VERIFY_FAILED: RteEventRef=OpEventGetDTCOfEvent_GetDTCOfEvent_EvtInfo_AutoCreatedDemEvent_NVM_E_VERIFY_FAILED
        OpEventGetEventFreezeFrameData_GetEventFreezeFrameData_EvtInfo_AutoCreatedDemEvent_NVM_E_WRONG_BLOCK_ID: RteEventRef=OpEventGetEventFreezeFrameData_GetEventFreezeFrameData_EvtInfo_AutoCreatedDemEvent_NVM_E_WRONG_BLOCK_ID
        OpEventGetDTCOfEvent_GetDTCOfEvent_EvtInfo_AutoCreatedDemEvent_NVM_E_REQ_FAILED: RteEventRef=OpEventGetDTCOfEvent_GetDTCOfEvent_EvtInfo_AutoCreatedDemEvent_NVM_E_REQ_FAILED
        OpEventGetEventFailed_GetEventFailed_EvtInfo_AutoCreatedDemEvent_NVM_E_WRONG_BLOCK_ID: RteEventRef=OpEventGetEventFailed_GetEventFailed_EvtInfo_AutoCreatedDemEvent_NVM_E_WRONG_BLOCK_ID
        OpEventGetEventFailed_GetEventFailed_EvtInfo_AutoCreatedDemEvent_NVM_E_REQ_FAILED: RteEventRef=OpEventGetEventFailed_GetEventFailed_EvtInfo_AutoCreatedDemEvent_NVM_E_REQ_FAILED
        OpEventGetEventFreezeFrameData_GetEventFreezeFrameData_EvtInfo_AutoCreatedDemEvent_NVM_E_REQ_FAILED: RteEventRef=OpEventGetEventFreezeFrameData_GetEventFreezeFrameData_EvtInfo_AutoCreatedDemEvent_NVM_E_REQ_FAILED
        OpEventGetFaultDetectionCounter_GetFaultDetectionCounter_EvtInfo_AutoCreatedDemEvent_NVM_E_REQ_FAILED: RteEventRef=OpEventGetFaultDetectionCounter_GetFaultDetectionCounter_EvtInfo_AutoCreatedDemEvent_NVM_E_REQ_FAILED
        OpEventGetEventFreezeFrameData_GetEventFreezeFrameData_EvtInfo_AutoCreatedDemEvent_NVM_E_VERIFY_FAILED: RteEventRef=OpEventGetEventFreezeFrameData_GetEventFreezeFrameData_EvtInfo_AutoCreatedDemEvent_NVM_E_VERIFY_FAILED
        OpEventGetEventTested_GetEventTested_EvtInfo_AutoCreatedDemEvent_NVM_E_WRONG_BLOCK_ID: RteEventRef=OpEventGetEventTested_GetEventTested_EvtInfo_AutoCreatedDemEvent_NVM_E_WRONG_BLOCK_ID
        OpEventGetEventFailed_GetEventFailed_EvtInfo_AutoCreatedDemEvent_NVM_E_WRITE_PROTECTED: RteEventRef=OpEventGetEventFailed_GetEventFailed_EvtInfo_AutoCreatedDemEvent_NVM_E_WRITE_PROTECTED
        OpEventGetEventFreezeFrameData_GetEventFreezeFrameData_EvtInfo_AutoCreatedDemEvent_NVM_E_WRITE_PROTECTED: RteEventRef=OpEventGetEventFreezeFrameData_GetEventFreezeFrameData_EvtInfo_AutoCreatedDemEvent_NVM_E_WRITE_PROTECTED
        OpEventGetEventExtendedDataRecord_GetEventExtendedDataRecord_EvtInfo_AutoCreatedDemEvent_NVM_E_WRITE_PROTECTED: RteEventRef=OpEventGetEventExtendedDataRecord_GetEventExtendedDataRecord_EvtInfo_AutoCreatedDemEvent_NVM_E_WRITE_PROTECTED
        OpEventGetEventTested_GetEventTested_EvtInfo_AutoCreatedDemEvent_NVM_E_VERIFY_FAILED: RteEventRef=OpEventGetEventTested_GetEventTested_EvtInfo_AutoCreatedDemEvent_NVM_E_VERIFY_FAILED
        OpEventGetEventExtendedDataRecord_GetEventExtendedDataRecord_EvtInfo_AutoCreatedDemEvent_NVM_E_VERIFY_FAILED: RteEventRef=OpEventGetEventExtendedDataRecord_GetEventExtendedDataRecord_EvtInfo_AutoCreatedDemEvent_NVM_E_VERIFY_FAILED
        OpEventGetFaultDetectionCounter_GetFaultDetectionCounter_EvtInfo_AutoCreatedDemEvent_NVM_E_WRONG_BLOCK_ID: RteEventRef=OpEventGetFaultDetectionCounter_GetFaultDetectionCounter_EvtInfo_AutoCreatedDemEvent_NVM_E_WRONG_BLOCK_ID
        OpEventGetEventStatus_GetEventStatus_EvtInfo_AutoCreatedDemEvent_NVM_E_REQ_FAILED: RteEventRef=OpEventGetEventStatus_GetEventStatus_EvtInfo_AutoCreatedDemEvent_NVM_E_REQ_FAILED
        OpEventDcmGetNextFilteredDTCAndFDC_DcmGetNextFilteredDTCAndFDC_Dcm: RteEventRef=OpEventDcmGetNextFilteredDTCAndFDC_DcmGetNextFilteredDTCAndFDC_Dcm
        OpEventClearDTC_ClearDTC_Cdd: RteEventRef=OpEventClearDTC_ClearDTC_Cdd
        OpEventPostRunRequested_GetPostRunRequested_DemServices: RteEventRef=OpEventPostRunRequested_GetPostRunRequested_DemServices
        OpEventDcmEnableDTCSetting_DcmEnableDTCSetting_Dcm: RteEventRef=OpEventDcmEnableDTCSetting_DcmEnableDTCSetting_Dcm
        OpEventDcmClearDTC_DcmClearDTC_Dcm: RteEventRef=OpEventDcmClearDTC_DcmClearDTC_Dcm
        OpEventSetOperationCycleState_SetOperationCycleState_OpCycle_PowerCycle: RteEventRef=OpEventSetOperationCycleState_SetOperationCycleState_OpCycle_PowerCycle
        OpEventSetOperationCycleState_SetOperationCycleState_OpCycle_IgnitionCycle: RteEventRef=OpEventSetOperationCycleState_SetOperationCycleState_OpCycle_IgnitionCycle
        OpEventGetDebouncingOfEvent_GetDebouncingOfEvent_EvtInfo_AutoCreatedDemEvent_NVM_E_LOSS_OF_REDUNDANCY: RteEventRef=OpEventGetDebouncingOfEvent_GetDebouncingOfEvent_EvtInfo_AutoCreatedDemEvent_NVM_E_LOSS_OF_REDUNDANCY
        OpEventDcmGetExtendedDataRecordByDTC_DcmGetExtendedDataRecordByDTC_Dcm: RteEventRef=OpEventDcmGetExtendedDataRecordByDTC_DcmGetExtendedDataRecordByDTC_Dcm
        OpEventGetDebouncingOfEvent_GetDebouncingOfEvent_EvtInfo_AutoCreatedDemEvent_NVM_E_WRONG_BLOCK_ID: RteEventRef=OpEventGetDebouncingOfEvent_GetDebouncingOfEvent_EvtInfo_AutoCreatedDemEvent_NVM_E_WRONG_BLOCK_ID
        OpEventGetDebouncingOfEvent_GetDebouncingOfEvent_EvtInfo_AutoCreatedDemEvent_NVM_E_REQ_FAILED: RteEventRef=OpEventGetDebouncingOfEvent_GetDebouncingOfEvent_EvtInfo_AutoCreatedDemEvent_NVM_E_REQ_FAILED
        OpEventGetDebouncingOfEvent_GetDebouncingOfEvent_EvtInfo_AutoCreatedDemEvent_NVM_E_VERIFY_FAILED: RteEventRef=OpEventGetDebouncingOfEvent_GetDebouncingOfEvent_EvtInfo_AutoCreatedDemEvent_NVM_E_VERIFY_FAILED
        OpEventGetDebouncingOfEvent_GetDebouncingOfEvent_EvtInfo_AutoCreatedDemEvent_ECUM_E_RAM_CHECK_FAILED: RteEventRef=OpEventGetDebouncingOfEvent_GetDebouncingOfEvent_EvtInfo_AutoCreatedDemEvent_ECUM_E_RAM_CHECK_FAILED
        OpEventGetNumberOfEventMemoryEntries_GetNumberOfEventMemoryEntries_OverflowIndPrimaryMemory: RteEventRef=OpEventGetNumberOfEventMemoryEntries_GetNumberOfEventMemoryEntries_OverflowIndPrimaryMemory
        OpEventGetDebouncingOfEvent_GetDebouncingOfEvent_GeneralEventInfo: RteEventRef=OpEventGetDebouncingOfEvent_GetDebouncingOfEvent_GeneralEventInfo
        OpEventDcmGetFreezeFrameDataByDTC_DcmGetFreezeFrameDataByDTC_Dcm: RteEventRef=OpEventDcmGetFreezeFrameDataByDTC_DcmGetFreezeFrameDataByDTC_Dcm
        OpEventGetDebouncingOfEvent_GetDebouncingOfEvent_EvtInfo_AutoCreatedDemEvent_NVM_E_WRITE_PROTECTED: RteEventRef=OpEventGetDebouncingOfEvent_GetDebouncingOfEvent_EvtInfo_AutoCreatedDemEvent_NVM_E_WRITE_PROTECTED
        OpEventGetDebouncingOfEvent_GetDebouncingOfEvent_EvtInfo_AutoCreatedDemEvent_ECUM_E_CONFIGURATION_DATA_INCONSISTENT: RteEventRef=OpEventGetDebouncingOfEvent_GetDebouncingOfEvent_EvtInfo_AutoCreatedDemEvent_ECUM_E_CONFIGURATION_DATA_INCONSISTENT
        OpEventGetDebouncingOfEvent_GetDebouncingOfEvent_EvtInfo_AutoCreatedDemEvent_NVM_E_INTEGRITY_FAILED: RteEventRef=OpEventGetDebouncingOfEvent_GetDebouncingOfEvent_EvtInfo_AutoCreatedDemEvent_NVM_E_INTEGRITY_FAILED
        OpEventGetDebouncingOfEvent_GetDebouncingOfEvent_EvtInfo_AutoCreatedDemEvent_NVM_E_QUEUE_OVERFLOW: RteEventRef=OpEventGetDebouncingOfEvent_GetDebouncingOfEvent_EvtInfo_AutoCreatedDemEvent_NVM_E_QUEUE_OVERFLOW
    Rte (RteBswModuleInstance): RteBswImplementationRef=Rte_Impl, RteBswModuleConfigurationRef=Rte
    BswM_EcuSwComposition (RteSwComponentInstance): RteSoftwareComponentInstanceRef=BswM
      Timer_BswM_MainFunction (RteEventToTaskMapping):
        RteImmediateRestart = false
        RtePositionInTask = 25
        RteEventRef = Timer_BswM_MainFunction
        RteMappedToTaskRef = SchM_Task
        RteUsedOsEventRef = Rte_Ev_Cyclic2_SchM_Task_0_10ms
        RteUsedOsAlarmRef = Rte_Al_TE2_SchM_Task_0_10ms
    3 x RteSwComponentType:
      CtApMySWC: RteComponentTypeRef=CtApMySwc
        ComponentTypeCalibration (RteComponentTypeCalibration): RteCalibrationSupportEnabled=false
      CtSaDoor: RteComponentTypeRef=CtSaDoor, RteImplementationRef=CtSaDoor_Implementation
        ComponentTypeCalibration (RteComponentTypeCalibration): RteCalibrationSupportEnabled=false
      CtSaInteriorLight: RteComponentTypeRef=CtSaInteriorLight, RteImplementationRef=CtSaInteriorLight_Implementation
        ComponentTypeCalibration (RteComponentTypeCalibration): RteCalibrationSupportEnabled=false
    4 x RteSwComponentInstance:
      CpApMySWC_EcuSwComposition: RteSoftwareComponentInstanceRef=CpApMySwc
        DRT_RCtApMySwcCode_PpDoorStateFrontLeft_Element_001 (RteEventToTaskMapping): RteImmediateRestart=false, RtePositionInTask=0, RteEventRef=DRT_RCtApMySwcCode_PpDoorStateFrontLeft_Element, RteMappedToTaskRef=My_Task
        DRT_RCtApMySwcCode_PpDoorStateFrontRight_Element_001 (RteEventToTaskMapping): RteImmediateRestart=false, RtePositionInTask=0, RteEventRef=DRT_RCtApMySwcCode_PpDoorStateFrontRight_Element, RteMappedToTaskRef=My_Task
      CpSaDoorFrontLeft_EcuSwComposition: RteSoftwareComponentInstanceRef=CpSaDoorFrontLeft
        TMT_RCtSaDoorReadDoor (RteEventToTaskMapping):
          RteImmediateRestart = false
          RtePositionInTask = 0
          RteEventRef = TMT_RCtSaDoorReadDoor
          RteMappedToTaskRef = IO_Task
          RteUsedOsEventRef = Rte_Ev_Cyclic_IO_Task_0_200ms
          RteUsedOsAlarmRef = Rte_Al_TE_IO_Task_0_200ms
      CpSaDoorFrontRight_EcuSwComposition: RteSoftwareComponentInstanceRef=CpSaDoorFrontRight
        TMT_RCtSaDoorReadDoor (RteEventToTaskMapping):
          RteImmediateRestart = false
          RtePositionInTask = 1
          RteEventRef = TMT_RCtSaDoorReadDoor
          RteMappedToTaskRef = IO_Task
          RteUsedOsEventRef = Rte_Ev_Cyclic_IO_Task_0_200ms
          RteUsedOsAlarmRef = Rte_Al_TE_IO_Task_0_200ms
      CpSaInteriorLightFront_EcuSwComposition: RteSoftwareComponentInstanceRef=CpSaInteriorLightFront
        DRT_RCtSaInteriorLightSwitchLight_PpLightState_Element (RteEventToTaskMapping):
          RteImmediateRestart = false
          RtePositionInTask = 2
          RteEventRef = DRT_RCtSaInteriorLightSwitchLight_PpLightState_Element
          RteMappedToTaskRef = IO_Task
          RteUsedOsEventRef = Rte_Ev_Run_CpSaInteriorLightFront_RCtSaInteriorLightSwitchLight
    Can_0 (RteBswModuleInstance): RteBswImplementationRef=Can_Impl, RteBswModuleConfigurationRef=Can
      3 x RteBswEventToTaskMapping, all with RteBswImmediateRestart=false:
        Can_MainFunction_BusOffTimingEvent0: RteBswEventRef=Can_MainFunction_BusOffTimingEvent0
        Can_MainFunction_WakeupTimingEvent0: RteBswEventRef=Can_MainFunction_WakeupTimingEvent0
        Can_MainFunction_ModeTimingEvent0: RteBswEventRef=Can_MainFunction_ModeTimingEvent0
      7 x RteBswExclusiveAreaImpl, all with RteExclusiveAreaImplMechanism=ALL_INTERRUPT_BLOCKING:
        CAN_EXCLUSIVE_AREA_{0..6}: RteBswExclusiveAreaRef=CAN_EXCLUSIVE_AREA_{0..6}
  module config EcuM: implementation-config-variant=VARIANT-PRE-COMPILE, module-description=EcuM_Impl
    EcuMGeneral:
      EcuMDevErrorDetect = true
      EcuMIncludeDem = false
      EcuMIncludeDet = true
      EcuMMainFunctionPeriod = 0.01
      EcuMVersionInfoApi = false
      EcuMDeferredBswMNotification = false
      EcuMSlaveCoreHandling = false
      EcuMEnableFixBehavior = false
      EcuMGeneration: EcuMOutOfBoundsWriteSanitizer=false, EcuMOutOfBoundsReadSanitizer=false, EcuMInterfacesForDeactivatedData=false
    EcuMFlexGeneral: EcuMEnableDefBehaviour=true
    EcuMConfiguration
      EcuMFlexConfiguration: EcuMFlexModuleConfigurationRef=CanConfigSet, EcuMNormalMcuModeRef=McuModeSettingConf, EcuMFlexModuleConfigurationRef=DemConfigSet
        ECUM_RESET_WDG (EcuMResetMode): EcuMResetModeId=1
        ECUM_CAUSE_DCM (EcuMShutdownCause): EcuMShutdownCauseId=3
        ECUM_CAUSE_UNKNOWN (EcuMShutdownCause): EcuMShutdownCauseId=0
        ECUM_RESET_IO (EcuMResetMode): EcuMResetModeId=2
        ECUM_RESET_MCU (EcuMResetMode): EcuMResetModeId=0
        ECUM_CAUSE_WDGM (EcuMShutdownCause): EcuMShutdownCauseId=2
        ECUM_RESET_WAKEUP (EcuMResetMode): EcuMResetModeId=3
        ECUM_CAUSE_ECU_STATE (EcuMShutdownCause): EcuMShutdownCauseId=1
        EcuMFlexUserConfig: EcuMGoDownRequestID=42, EcuMFlexUser=0
        EcuMGoDownAllowedUsers: EcuMGoDownAllowedUserRef=EcuMFlexUserConfig
      EcuMCommonConfiguration: EcuMConfigConsistencyHash=6101825474368961796, EcuMDefaultAppMode=OSDEFAULTAPPMODE, EcuMOSResource=RES_ECUM
        EcuMDefaultShutdownTarget: EcuMDefaultState=EcuMStateReset, EcuMDefaultResetModeRef=ECUM_RESET_MCU
        5 x EcuMWakeupSource, all with EcuMValidationTimeout=0, EcuMWakeupSourcePolling=false, EcuMCheckWakeupTimeout=0:
          ECUM_WKSOURCE_POWER: EcuMWakeupSourceId=0
          ECUM_WKSOURCE_INTERNAL_RESET: EcuMWakeupSourceId=2
          ECUM_WKSOURCE_INTERNAL_WDG: EcuMWakeupSourceId=3
          ECUM_WKSOURCE_RESET: EcuMWakeupSourceId=1
          ECUM_WKSOURCE_EXTERNAL_WDG: EcuMWakeupSourceId=4
        EcuMSleepMode:
          EcuMSleepModeId = 0
          EcuMSleepModeMcuModeRef = McuModeSettingConf
          EcuMWakeupSourceMask = ECUM_WKSOURCE_EXTERNAL_WDG
          EcuMWakeupSourceMask = ECUM_WKSOURCE_INTERNAL_RESET
          EcuMWakeupSourceMask = ECUM_WKSOURCE_INTERNAL_WDG
          EcuMWakeupSourceMask = ECUM_WKSOURCE_POWER
          EcuMWakeupSourceMask = ECUM_WKSOURCE_RESET
        EcuMDriverInitListOne
          EcuMDriverInitItem: EcuMModuleID=Code, EcuMAdditionalInitCode=BswInitListOne();
        EcuMDemEventParameterRefs:
          ECUM_E_CONFIGURATION_DATA_INCONSISTENT = AutoCreatedDemEvent_ECUM_E_CONFIGURATION_DATA_INCONSISTENT
          ECUM_E_RAM_CHECK_FAILED = AutoCreatedDemEvent_ECUM_E_RAM_CHECK_FAILED
        EcuMDriverRestartList
        ECUM_WKSOURCE_CAN (EcuMWakeupSource): EcuMWakeupSourceId=5, EcuMWakeupSourcePolling=false, EcuMComMChannelRef=CAN00_f26020e5
  module config CanNm: implementation-config-variant=VARIANT-PRE-COMPILE, module-description=CanNm_Impl
    CanNmGlobalConfig:
      CanNmComUserDataSupport = false
      CanNmPnEiraCalcEnabled = false
      CanNmUserDataEnabled = true
      CanNmBusLoadReductionEnabled = false
      CanNmBusSynchronizationEnabled = false
      CanNmComControlEnabled = false
      CanNmCoordinatorSyncSupport = false
      CanNmDevErrorDetect = true
      CanNmImmediateRestartEnabled = false
      CanNmImmediateTxconfEnabled = false
      CanNmMainFunctionPeriod = 0.01
      CanNmNodeDetectionEnabled = false
      CanNmPassiveModeEnabled = false
      CanNmPduRxIndicationEnabled = false
      CanNmRemoteSleepIndEnabled = false
      CanNmRepeatMsgIndEnabled = false
      CanNmStateChangeIndEnabled = true
      CanNmVersionInfoApi = false
      CanNmDisableTxErrReport = false
      CanNmApiOptimization = false
      CanNmCanIfRangeConfigDLCCheck = false
      CanNmNodeIdEnabled = false
      CanNmRuntimeMeasurementSupport = false
      CanNmNumberOfChannels = 1
      CAN00_17d0077e (CanNmChannelConfig):
        CanNmMsgCycleTime = 0.1
        CanNmMsgReducedTime = 0.001
        CanNmPduCbvPosition = CANNM_PDU_OFF
        CanNmRepeatMessageTime = 4
        CanNmTimeoutTime = 1
        CanNmUserDataLength = 8
        CanNmWaitBusSleepTime = 0.75
        CanNmBusLoadReductionActive = false
        CanNmCarWakeUpRxEnabled = false
        CanNmImmediateNmTransmissions = 0
        CanNmMsgCycleOffset = 0
        CanNmMsgTimeoutTime = 0.06
        CanNmNodeId = 0
        CanNmPduNidPosition = CANNM_PDU_OFF
        CanNmRemoteSleepIndTime = 0.5
        CanNmActiveWakeupBitEnabled = false
        CanNmComMNetworkHandleRef = CAN00_f26020e5
        CAN00_17d0077e_RxPdu_f27871aa (CanNmRxPdu): CanNmRxPduId=0, CanNmRxPduRef=CAN00_NmRxPdu_f26020e5
        msg_nm_MyECU_oCAN00_3abd61be (CanNmTxPdu): CanNmTxConfirmationPduId=0, CanNmTxPduRef=msg_nm_MyECU_5fb848b3
      CanNmGeneration: CanNmOutOfBoundsWriteSanitizer=false, CanNmOutOfBoundsReadSanitizer=false, CanNmInterfacesForDeactivatedData=false
  module config ComM: implementation-config-variant=VARIANT-PRE-COMPILE, module-description=ComM_Impl
    ComMGeneral:
      ComMPncSupport = false
      ComMDevErrorDetect = true
      ComMEcuGroupClassification = 3
      ComMModeLimitationEnabled = false
      ComMSynchronousWakeUp = true
      ComMTMinFullComModeDuration = 5
      ComMVersionInfoApi = true
      ComMWakeupInhibitionEnabled = false
      ComMGeneration: ComMOutOfBoundsWriteSanitizer=false, ComMOutOfBoundsReadSanitizer=false
    ComMConfigSet: ComMPncEnabled=false
      CAN00_f26020e5 (ComMChannel):
        ComMBusType = COMM_BUS_TYPE_CAN
        ComMChannelId = 0
        ComMFullCommRequestNotificationEnabled = false
        ComMMainFunctionPeriod = 0.02
        ComMNoCom = false
        ComMNoWakeup = false
        CHNL_f276589c (ComMUserPerChannel): ComMUserChannel=USR_CHNL_f276589c
        ComMNetworkManagement: ComMNmVariant=FULL, ComMPncNmRequest=true
      USR_CHNL_f276589c (ComMUser): ComMUserIdentifier=0, ComMUserModeNotification=true
  module config Mcu: implementation-config-variant=VARIANT-PRE-COMPILE, module-description=Mcu_Impl
    McuGeneralConfiguration: McuDevErrorDetect=true, McuGetRamStateApi=false, McuInitClock=true, McuNoPll=true, McuPerformResetApi=true, McuVersionInfoApi=true
    McuModuleConfiguration
      McuClockSettingConfig
        McuClockReferencePoint: McuClockReferencePointFrequency=80000000
      McuModeSettingConf: McuMode=1
    McuPublishedInformation
      McuResetReasonConf: McuResetReason=0
    VectorCommonData (McuCommonData): BswmdVersion=2.00.00
  module config Os: implementation-config-variant=VARIANT-PRE-COMPILE, module-description=Os_Impl
    OsOS:
      OsStackMonitoring = false
      OsStatus = EXTENDED
      OsUseGetServiceId = true
      OsUseParameterAccess = true
      OsUseResScheduler = true
      OsOSTypeHeaderInclude = true
      OsOSCompiler = GHS
      OsScalabilityClass = SC1
      OsOSStackUsageMeasurement = AUTO
      OsOSCallISRHooks = false
      OsOSSupportFPU = false
      OsOSEnumeratedUnhandledISRs = false
      OsOSORTIDebugSupport = false
      OsOSUserConfigurationVersion = 1
      OsOSSystemStackSize = 200
      OsOSOSInternalChecks = Additional
      OsOSORTIDebugLevel = ORTI_20
      OsOSTimingHooks = 
      OsOSSCHEDULE
        AUTO
      OsOSCC
        AUTO
      OsOSProtectionHookReaction
        Selected: OsOSKILLTASKISR=false, OsOSKILLAPPL=false, OsOSKILLAPPL_RESTART=false, OsOSSHUTDOWN=false
      OsOSTimingMeasurement
        FALSE
      OsHooks: OsErrorHook=true, OsPostTaskHook=false, OsPreTaskHook=false, OsShutdownHook=true, OsStartupHook=false, OsProtectionHook=false
      OsOSPreAlarmHook
        FALSE
      OsOSAPIOptimization
        Automatic
      OsOSUseSemaphores
        FALSE
    VectorCommonData (OsCommonData): BswmdVersion=1.06.03
    OsImplementationInformation: OsVectorOilVersion=4.1, OsVectorImplementationName=RH850_F1K.i41, OsBswmdStyleVersion=2
    OSDEFAULTAPPMODE (OsAppMode)
    SystemTimer (OsCounter): OsCounterMaxAllowedValue=65535, OsCounterTicksPerBase=1, OsCounterMinCycle=1, OsSecondsPerTick=1234567890, OsCounterType=HARDWARE
    RES_SCHEDULER (OsResource): OsResourceProperty=STANDARD
    SchM_Task (OsTask):
      OsTaskActivation = 1
      OsTaskPriority = 6
      OsTaskSchedule = NON
      OsTaskTYPE = EXTENDED
      OsTaskNotUsingSchedule = false
      OsTaskStackSize = 300
      OsTaskEventRef = Rte_Ev_Cyclic2_SchM_Task_0_10ms
      OsTaskEventRef = Rte_Ev_Cyclic2_SchM_Task_0_20ms
      OsTaskResourceRef = RES_ECUM
      OsTaskEventRef = Rte_Ev_Run_Fee_Fee_MainFunction
    Rte_Ev_Cyclic2_SchM_Task_0_10ms (OsEvent)
    Rte_Ev_Cyclic2_SchM_Task_0_20ms (OsEvent)
    Rte_Al_TE2_SchM_Task_0_10ms (OsAlarm): OsAlarmCounterRef=SystemTimer
      OsAlarmAction
        OsAlarmSetEvent: OsAlarmSetEventRef=Rte_Ev_Cyclic2_SchM_Task_0_10ms, OsAlarmSetEventTaskRef=SchM_Task
    Rte_Al_TE2_SchM_Task_0_20ms (OsAlarm): OsAlarmCounterRef=SystemTimer
      OsAlarmAction
        OsAlarmSetEvent: OsAlarmSetEventRef=Rte_Ev_Cyclic2_SchM_Task_0_20ms, OsAlarmSetEventTaskRef=SchM_Task
    RES_ECUM (OsResource): OsResourceProperty=STANDARD
    Rte_Al_TE_Fee_Fee_MainFunction (OsAlarm): OsAlarmCounterRef=SystemTimer
      OsAlarmAction
        OsAlarmSetEvent: OsAlarmSetEventRef=Rte_Ev_Run_Fee_Fee_MainFunction, OsAlarmSetEventTaskRef=SchM_Task
    Rte_Ev_Run_Fee_Fee_MainFunction (OsEvent)
    3 x OsTask, all with OsTaskSchedule=NON, OsTaskNotUsingSchedule=false, OsTaskStackSize=300:
      Init_Task: OsTaskActivation=1, OsTaskPriority=4, OsTaskTYPE=BASIC
        OsTaskAutostart: OsTaskAppModeRef=OSDEFAULTAPPMODE
      My_Task: OsTaskActivation=2, OsTaskPriority=2, OsTaskTYPE=BASIC
      IO_Task: OsTaskActivation=1, OsTaskPriority=3, OsTaskTYPE=EXTENDED, OsTaskEventRef=Rte_Ev_Cyclic_IO_Task_0_200ms, OsTaskEventRef=Rte_Ev_Run_CpSaInteriorLightFront_RCtSaInteriorLightSwitchLight
    Rte_Al_TE_IO_Task_0_200ms (OsAlarm): OsAlarmCounterRef=SystemTimer
      OsAlarmAction
        OsAlarmSetEvent: OsAlarmSetEventRef=Rte_Ev_Cyclic_IO_Task_0_200ms, OsAlarmSetEventTaskRef=IO_Task
    Rte_Ev_Cyclic_IO_Task_0_200ms (OsEvent)
    Rte_Ev_Run_CpSaInteriorLightFront_RCtSaInteriorLightSwitchLight (OsEvent)
  module config Crc: implementation-config-variant=VARIANT-PRE-COMPILE, module-description=Crc_Impl
    CrcGeneral:
      Crc16Mode = CRC_16_RUNTIME
      Crc32Mode = CRC_32_RUNTIME
      Crc8Mode = CRC_8_RUNTIME
      CrcVersionInfoApi = true
      Crc32P4Mode = CRC_32P4_RUNTIME
      Crc8H2FMode = CRC_8H2F_RUNTIME
  module config Fee: implementation-config-variant=VARIANT-PRE-COMPILE, module-description=Fee_Impl
    FeeGeneral:
      FeeDevErrorDetect = true
      FeeIndex = 0
      FeeNvmJobEndNotification = NvM_JobEndNotification
      FeeNvmJobErrorNotification = NvM_JobErrorNotification
      FeePollingMode = true
      FeeVersionInfoApi = true
      FeeInternalBufferSize = 64
      FeeMainFunctionPeriod = 0.005
      FeeMainFunctionTriggering = FixedCycleTime
      FeeDevErrorChecks: FeeDebugReporting=true, FeeDetErrorhook=Det_ReportError, FeeDetIncludeFile=Det.h
    FeePublishedInformation: FeeBlockOverhead=2, FeeMaximumBlockingTime=1, FeePageOverhead=0, FeeChunkHeader=16, FeeChunkLink=8, FeeSectorHeader=8
    FeeSpecificFeatures:
      FeeApplErrorCallbackFunction = Appl_CriticalErrorCallback
      FeeApplErrorCallbackIncludeFile = Appl_Include.h
      FeeGetEraseCycleApi = false
      FeeGetWriteCycleApi = false
      FeeUseApplErrorCallback = false
      FeeUseJobCache = false
      FeeForceSectorSwitchApi = false
      FeeDataConversionApi = false
      FeeFblConfig = false
      FeeMaxLinkTableSize = 4095
      FeeFssControlApi = false
    FeePartitionConfiguration:
      FeeBssThresholdReserved = 2048
      FeeFssThresholdReserved = 1024
      FeeLowerSectorAddress = 0
      FeeLowerSectorSize = 16384
      FeeUpperSectorAddress = 16384
      FeeUpperSectorSize = 16384
      FeeAddressAlignment = 8
      FeeWriteAlignment = 8
      FeePartitionDevice = FlsConfigSet
    11 x FeeBlockConfiguration, all with FeeBlockIdFixed=false, FeeBlockIsCritical=false, FeeImmediateData=false, FeeNumberOfChunkInstances=3, FeeNumberOfWriteCycles=10000, FeePartition=FeePartitionConfiguration:
      FeeConfigBlock: FeeBlockNumber=176, FeeBlockSize=4, FeeNumberOfDatasets=2, FeeBlockId=0
      FeeDemAdminDataBlock: FeeBlockNumber=48, FeeBlockSize=12, FeeNumberOfDatasets=1, FeeBlockId=1
      FeeDemPrimaryDataBlock0: FeeBlockNumber=64, FeeBlockSize=14, FeeNumberOfDatasets=1, FeeBlockId=2
      FeeDemPrimaryDataBlock1: FeeBlockNumber=16, FeeBlockSize=14, FeeNumberOfDatasets=1, FeeBlockId=3
      FeeDemPrimaryDataBlock2: FeeBlockNumber=128, FeeBlockSize=14, FeeNumberOfDatasets=1, FeeBlockId=4
      FeeDemPrimaryDataBlock3: FeeBlockNumber=80, FeeBlockSize=14, FeeNumberOfDatasets=1, FeeBlockId=5
      FeeDemPrimaryDataBlock4: FeeBlockNumber=144, FeeBlockSize=14, FeeNumberOfDatasets=1, FeeBlockId=6
      FeeDemPrimaryDataBlock5: FeeBlockNumber=32, FeeBlockSize=14, FeeNumberOfDatasets=1, FeeBlockId=7
      FeeDemPrimaryDataBlock6: FeeBlockNumber=96, FeeBlockSize=14, FeeNumberOfDatasets=1, FeeBlockId=8
      FeeDemPrimaryDataBlock7: FeeBlockNumber=112, FeeBlockSize=14, FeeNumberOfDatasets=1, FeeBlockId=9
      FeeDemStatusDataBlock: FeeBlockNumber=160, FeeBlockSize=20, FeeNumberOfDatasets=1, FeeBlockId=10
  module config Fls: implementation-config-variant=VARIANT-PRE-COMPILE, module-description=Fls_Impl
    FlsConfigSet: FlsMaxReadFastMode=64, FlsMaxReadNormalMode=32, FlsMaxWriteFastMode=8, FlsMaxWriteNormalMode=8, FlsDefaultMode=MEMIF_MODE_SLOW
      FlsSectorList
        128 x FlsSector, all with FlsNumberOfSectors=1, FlsSectorSize=1024, FlsPageSize=2:
          FlsSector000: FlsSectorStartaddress=0
          FlsSector001: FlsSectorStartaddress=1024
          FlsSector002: FlsSectorStartaddress=2048
          FlsSector003: FlsSectorStartaddress=3072
          FlsSector004: FlsSectorStartaddress=4096
          FlsSector005: FlsSectorStartaddress=5120
          FlsSector006: FlsSectorStartaddress=6144
          FlsSector007: FlsSectorStartaddress=7168
          FlsSector008: FlsSectorStartaddress=8192
          FlsSector009: FlsSectorStartaddress=9216
          FlsSector010: FlsSectorStartaddress=10240
          FlsSector011: FlsSectorStartaddress=11264
          FlsSector012: FlsSectorStartaddress=12288
          FlsSector013: FlsSectorStartaddress=13312
          FlsSector014: FlsSectorStartaddress=14336
          FlsSector015: FlsSectorStartaddress=15360
          FlsSector016: FlsSectorStartaddress=16384
          FlsSector017: FlsSectorStartaddress=17408
          FlsSector018: FlsSectorStartaddress=18432
          FlsSector019: FlsSectorStartaddress=19456
          FlsSector020: FlsSectorStartaddress=20480
          FlsSector021: FlsSectorStartaddress=21504
          FlsSector022: FlsSectorStartaddress=22528
          FlsSector023: FlsSectorStartaddress=23552
          FlsSector024: FlsSectorStartaddress=24576
          FlsSector025: FlsSectorStartaddress=25600
          FlsSector026: FlsSectorStartaddress=26624
          FlsSector027: FlsSectorStartaddress=27648
          FlsSector028: FlsSectorStartaddress=28672
          FlsSector029: FlsSectorStartaddress=29696
          FlsSector030: FlsSectorStartaddress=30720
          FlsSector031: FlsSectorStartaddress=31744
          FlsSector032: FlsSectorStartaddress=32768
          FlsSector033: FlsSectorStartaddress=33792
          FlsSector034: FlsSectorStartaddress=34816
          FlsSector035: FlsSectorStartaddress=35840
          FlsSector036: FlsSectorStartaddress=36864
          FlsSector037: FlsSectorStartaddress=37888
          FlsSector038: FlsSectorStartaddress=38912
          FlsSector039: FlsSectorStartaddress=39936
          FlsSector040: FlsSectorStartaddress=40960
          FlsSector041: FlsSectorStartaddress=41984
          FlsSector042: FlsSectorStartaddress=43008
          FlsSector043: FlsSectorStartaddress=44032
          FlsSector044: FlsSectorStartaddress=45056
          FlsSector045: FlsSectorStartaddress=46080
          FlsSector046: FlsSectorStartaddress=47104
          FlsSector047: FlsSectorStartaddress=48128
          FlsSector048: FlsSectorStartaddress=49152
          FlsSector049: FlsSectorStartaddress=50176
          FlsSector050: FlsSectorStartaddress=51200
          FlsSector051: FlsSectorStartaddress=52224
          FlsSector052: FlsSectorStartaddress=53248
          FlsSector053: FlsSectorStartaddress=54272
          FlsSector054: FlsSectorStartaddress=55296
          FlsSector055: FlsSectorStartaddress=56320
          FlsSector056: FlsSectorStartaddress=57344
          FlsSector057: FlsSectorStartaddress=58368
          FlsSector058: FlsSectorStartaddress=59392
          FlsSector059: FlsSectorStartaddress=60416
          FlsSector060: FlsSectorStartaddress=61440
          FlsSector061: FlsSectorStartaddress=62464
          FlsSector062: FlsSectorStartaddress=63488
          FlsSector063: FlsSectorStartaddress=64512
          FlsSector064: FlsSectorStartaddress=65536
          FlsSector065: FlsSectorStartaddress=66560
          FlsSector066: FlsSectorStartaddress=67584
          FlsSector067: FlsSectorStartaddress=68608
          FlsSector068: FlsSectorStartaddress=69632
          FlsSector069: FlsSectorStartaddress=70656
          FlsSector070: FlsSectorStartaddress=71680
          FlsSector071: FlsSectorStartaddress=72704
          FlsSector072: FlsSectorStartaddress=73728
          FlsSector073: FlsSectorStartaddress=74752
          FlsSector074: FlsSectorStartaddress=75776
          FlsSector075: FlsSectorStartaddress=76800
          FlsSector076: FlsSectorStartaddress=77824
          FlsSector077: FlsSectorStartaddress=78848
          FlsSector078: FlsSectorStartaddress=79872
          FlsSector079: FlsSectorStartaddress=80896
          FlsSector080: FlsSectorStartaddress=81920
          FlsSector081: FlsSectorStartaddress=82944
          FlsSector082: FlsSectorStartaddress=83968
          FlsSector083: FlsSectorStartaddress=84992
          FlsSector084: FlsSectorStartaddress=86016
          FlsSector085: FlsSectorStartaddress=87040
          FlsSector086: FlsSectorStartaddress=88064
          FlsSector087: FlsSectorStartaddress=89088
          FlsSector088: FlsSectorStartaddress=90112
          FlsSector089: FlsSectorStartaddress=91136
          FlsSector090: FlsSectorStartaddress=92160
          FlsSector091: FlsSectorStartaddress=93184
          FlsSector092: FlsSectorStartaddress=94208
          FlsSector093: FlsSectorStartaddress=95232
          FlsSector094: FlsSectorStartaddress=96256
          FlsSector095: FlsSectorStartaddress=97280
          FlsSector096: FlsSectorStartaddress=98304
          FlsSector097: FlsSectorStartaddress=99328
          FlsSector098: FlsSectorStartaddress=100352
          FlsSector099: FlsSectorStartaddress=101376
          FlsSector100: FlsSectorStartaddress=102400
          FlsSector101: FlsSectorStartaddress=103424
          FlsSector102: FlsSectorStartaddress=104448
          FlsSector103: FlsSectorStartaddress=105472
          FlsSector104: FlsSectorStartaddress=106496
          FlsSector105: FlsSectorStartaddress=107520
          FlsSector106: FlsSectorStartaddress=108544
          FlsSector107: FlsSectorStartaddress=109568
          FlsSector108: FlsSectorStartaddress=110592
          FlsSector109: FlsSectorStartaddress=111616
          FlsSector110: FlsSectorStartaddress=112640
          FlsSector111: FlsSectorStartaddress=113664
          FlsSector112: FlsSectorStartaddress=114688
          FlsSector113: FlsSectorStartaddress=115712
          FlsSector114: FlsSectorStartaddress=116736
          FlsSector115: FlsSectorStartaddress=117760
          FlsSector116: FlsSectorStartaddress=118784
          FlsSector117: FlsSectorStartaddress=119808
          FlsSector118: FlsSectorStartaddress=120832
          FlsSector119: FlsSectorStartaddress=121856
          FlsSector120: FlsSectorStartaddress=122880
          FlsSector121: FlsSectorStartaddress=123904
          FlsSector122: FlsSectorStartaddress=124928
          FlsSector123: FlsSectorStartaddress=125952
          FlsSector124: FlsSectorStartaddress=126976
          FlsSector125: FlsSectorStartaddress=128000
          FlsSector126: FlsSectorStartaddress=129024
          FlsSector127: FlsSectorStartaddress=130048
    FlsGeneral:
      FlsBaseAddress = 0
      FlsTotalSize = 131072
      FlsCancelApi = true
      FlsCompareApi = true
      FlsDevErrorDetect = true
      FlsDriverIndex = 0
      FlsGetJobResultApi = true
      FlsGetStatusApi = true
      FlsSetModeApi = true
      FlsVersionInfoApi = true
      FlsCfgIncludeList = Fee_Cbk.h
      FlsDataFile = .\..\..\CANoe\Fls_DataFile.txt
      FlsCfgEraseFlashOnSizeMismatch = true
      FlsCfgIsErasedCheck = true
    FlsPublishedInformation: FlsErasedValue=255
    VectorCommonData (FlsCommonData): BswmdVersion=3.00.00
  module config MemIf: implementation-config-variant=VARIANT-PRE-COMPILE, module-description=MemIf_Impl
    MemIfGeneral: MemIfDevErrorDetect=true, MemIfVersionInfoApi=true
    MemIfMemHwA: MemIfMemHwAId=0, MemIfMemHwARef=FeeGeneral
  module config NvM: implementation-config-variant=VARIANT-PRE-COMPILE, module-description=NvM_Impl
    NvMConfigBlock (NvMBlockDescriptor):
      NvMBlockCrcType = NVM_CRC16
      NvMCalcRamBlockCrc = false
      NvMNvramBlockIdentifier = 1
      NvMBlockManagementType = NVM_BLOCK_REDUNDANT
      NvMNvBlockNum = 2
      NvMBlockUseCrc = true
      NvMNvBlockLength = 2
      NvMBlockJobPriority = 127
      NvMBlockUseSyncMechanism = false
      NvMBlockWriteProt = false
      NvMBswMBlockStatusInformation = false
      NvMInitBlockCallback = NULL_PTR
      NvMMaxNumOfReadRetries = 0
      NvMMaxNumOfWriteRetries = 0
      NvMRamBlockDataAddress = NULL_PTR
      NvMReadRamBlockFromNvCallback = NULL_PTR
      NvMResistantToChangedSw = true
      NvMRomBlockDataAddress = NULL_PTR
      NvMRomBlockNum = 0
      NvMSelectBlockForReadAll = true
      NvMSelectBlockForWriteAll = true
      NvMSingleBlockCallback = NULL_PTR
      NvMStaticBlockIDCheck = false
      NvMWriteBlockOnce = false
      NvMWriteRamBlockToNvCallback = NULL_PTR
      NvMWriteVerification = false
      NvMWriteVerificationDataSize = 1
      NvMUseServicePorts = true
      NvMUseJobendCallback = false
      NvMUseInitCallback = false
      NvMAutomaticBlockLength = false
      NvMBlockLengthCheck = false
      NvMBlockLengthCheckType = true
      NvMTargetBlockReference
        NvMFeeRef: NvMNameOfFeeBlock=FeeConfigBlock
    NvMCommon:
      NvMApiConfigClass = NVM_API_CONFIG_CLASS_3
      NvMBswMMultiBlockJobStatusInformation = false
      NvMCompiledConfigId = 1
      NvMCrcNumOfBytes = 64
      NvMDatasetSelectionBits = 4
      NvMDevErrorDetect = true
      NvMDrvModeSwitch = false
      NvMDynamicConfiguration = false
      NvMJobPrioritization = false
      NvMMultiBlockCallback = NULL_PTR
      NvMPollingMode = true
      NvMRepeatMirrorOperations = 0
      NvMSetRamBlockStatusApi = true
      NvMSizeStandardJobQueue = 2
      NvMVersionInfoApi = false
      NvMMaxNoOfWriteRetries = 1
      NvMMainFunctionPeriod = 0.01
      NvMRepairRedundantBlocksApi = false
      NvMUseBlockIdCheck = false
    NvMCommonVendorParams:
      NvMMultiblockId = MultiBlockRequest
      NvMCrcIntBuffer = true
      NvMKillWriteAllApi = true
      NvMCfgCbkIncludeList = main.h
      NvMCfgCbkIncludeList = Dem.h
      NvMCfgCbkIncludeList = Dem_Cbk.h
    NvmDemEventParameterRefs:
      NVM_E_INTEGRITY_FAILED = AutoCreatedDemEvent_NVM_E_INTEGRITY_FAILED
      NVM_E_LOSS_OF_REDUNDANCY = AutoCreatedDemEvent_NVM_E_LOSS_OF_REDUNDANCY
      NVM_E_QUEUE_OVERFLOW = AutoCreatedDemEvent_NVM_E_QUEUE_OVERFLOW
      NVM_E_REQ_FAILED = AutoCreatedDemEvent_NVM_E_REQ_FAILED
      NVM_E_VERIFY_FAILED = AutoCreatedDemEvent_NVM_E_VERIFY_FAILED
      NVM_E_WRITE_PROTECTED = AutoCreatedDemEvent_NVM_E_WRITE_PROTECTED
      NVM_E_WRONG_BLOCK_ID = AutoCreatedDemEvent_NVM_E_WRONG_BLOCK_ID
    10 x NvMBlockDescriptor, all with NvMBlockCrcType=NVM_CRC16, NvMBlockManagementType=NVM_BLOCK_NATIVE, NvMResistantToChangedSw=true, NvMSelectBlockForReadAll=true, NvMSelectBlockForWriteAll=true, NvMWriteRamBlockToNvCallback=NULL_PTR, NvMUseJobendCallback=true, NvMSingleBlockCallback=Dem_NvM_JobFinished, NvMBswMBlockStatusInformation=false, NvMBlockUseCrc=true, NvMBlockUseSyncMechanism=false, NvMCalcRamBlockCrc=false, NvMBlockJobPriority=127, NvMBlockWriteProt=false, NvMMaxNumOfReadRetries=0, NvMMaxNumOfWriteRetries=0, NvMNvBlockNum=1, NvMReadRamBlockFromNvCallback=NULL_PTR, NvMRomBlockNum=0, NvMStaticBlockIDCheck=false, NvMWriteBlockOnce=false, NvMWriteVerification=false, NvMWriteVerificationDataSize=1, NvMUseServicePorts=false, NvMAutomaticBlockLength=false, NvMBlockLengthCheck=false, NvMBlockLengthCheckType=true:
      DemAdminDataBlock: NvMInitBlockCallback=Dem_NvM_InitAdminData, NvMUseInitCallback=true, NvMNvBlockLength=10, NvMNvramBlockIdentifier=2, NvMRamBlockDataAddress=Dem_Cfg_AdminData, NvMRomBlockDataAddress=NULL_PTR
        NvMTargetBlockReference
          NvMFeeRef: NvMNameOfFeeBlock=FeeDemAdminDataBlock
      DemStatusDataBlock: NvMInitBlockCallback=Dem_NvM_InitStatusData, NvMUseInitCallback=true, NvMNvBlockLength=18, NvMNvramBlockIdentifier=3, NvMRamBlockDataAddress=Dem_Cfg_StatusData, NvMRomBlockDataAddress=NULL_PTR
        NvMTargetBlockReference
          NvMFeeRef: NvMNameOfFeeBlock=FeeDemStatusDataBlock
      DemPrimaryDataBlock0: NvMInitBlockCallback=NULL_PTR, NvMUseInitCallback=false, NvMNvBlockLength=12, NvMNvramBlockIdentifier=4, NvMRamBlockDataAddress=Dem_PrimaryEntry_0, NvMRomBlockDataAddress=Dem_MemoryEntryInit
        NvMTargetBlockReference
          NvMFeeRef: NvMNameOfFeeBlock=FeeDemPrimaryDataBlock0
      DemPrimaryDataBlock1: NvMInitBlockCallback=NULL_PTR, NvMUseInitCallback=false, NvMNvBlockLength=12, NvMNvramBlockIdentifier=5, NvMRamBlockDataAddress=Dem_PrimaryEntry_1, NvMRomBlockDataAddress=Dem_MemoryEntryInit
        NvMTargetBlockReference
          NvMFeeRef: NvMNameOfFeeBlock=FeeDemPrimaryDataBlock1
      DemPrimaryDataBlock2: NvMInitBlockCallback=NULL_PTR, NvMUseInitCallback=false, NvMNvBlockLength=12, NvMNvramBlockIdentifier=6, NvMRamBlockDataAddress=Dem_PrimaryEntry_2, NvMRomBlockDataAddress=Dem_MemoryEntryInit
        NvMTargetBlockReference
          NvMFeeRef: NvMNameOfFeeBlock=FeeDemPrimaryDataBlock2
      DemPrimaryDataBlock3: NvMInitBlockCallback=NULL_PTR, NvMUseInitCallback=false, NvMNvBlockLength=12, NvMNvramBlockIdentifier=7, NvMRamBlockDataAddress=Dem_PrimaryEntry_3, NvMRomBlockDataAddress=Dem_MemoryEntryInit
        NvMTargetBlockReference
          NvMFeeRef: NvMNameOfFeeBlock=FeeDemPrimaryDataBlock3
      DemPrimaryDataBlock4: NvMInitBlockCallback=NULL_PTR, NvMUseInitCallback=false, NvMNvBlockLength=12, NvMNvramBlockIdentifier=8, NvMRamBlockDataAddress=Dem_PrimaryEntry_4, NvMRomBlockDataAddress=Dem_MemoryEntryInit
        NvMTargetBlockReference
          NvMFeeRef: NvMNameOfFeeBlock=FeeDemPrimaryDataBlock4
      DemPrimaryDataBlock5: NvMInitBlockCallback=NULL_PTR, NvMUseInitCallback=false, NvMNvBlockLength=12, NvMNvramBlockIdentifier=9, NvMRamBlockDataAddress=Dem_PrimaryEntry_5, NvMRomBlockDataAddress=Dem_MemoryEntryInit
        NvMTargetBlockReference
          NvMFeeRef: NvMNameOfFeeBlock=FeeDemPrimaryDataBlock5
      DemPrimaryDataBlock6: NvMInitBlockCallback=NULL_PTR, NvMUseInitCallback=false, NvMNvBlockLength=12, NvMNvramBlockIdentifier=10, NvMRamBlockDataAddress=Dem_PrimaryEntry_6, NvMRomBlockDataAddress=Dem_MemoryEntryInit
        NvMTargetBlockReference
          NvMFeeRef: NvMNameOfFeeBlock=FeeDemPrimaryDataBlock6
      DemPrimaryDataBlock7: NvMInitBlockCallback=NULL_PTR, NvMUseInitCallback=false, NvMNvBlockLength=12, NvMNvramBlockIdentifier=11, NvMRamBlockDataAddress=Dem_PrimaryEntry_7, NvMRomBlockDataAddress=Dem_MemoryEntryInit
        NvMTargetBlockReference
          NvMFeeRef: NvMNameOfFeeBlock=FeeDemPrimaryDataBlock7
  module config BswM: implementation-config-variant=VARIANT-PRE-COMPILE, module-description=BswM_Impl
    BswMGeneral:
      BswMMainFunctionPeriod = 0.01
      BswMVersionInfoApi = false
      BswMDevErrorDetect = true
      BswMCanSMEnabled = true
      BswMComMEnabled = true
      BswMDcmEnabled = false
      BswMEcuMEnabled = true
      BswMEthSMEnabled = false
      BswMFrSMEnabled = false
      BswMGenericRequestEnabled = true
      BswMLinSMEnabled = false
      BswMLinTPEnabled = false
      BswMNvMEnabled = true
      BswMJ1939NmEnabled = false
      BswMNmEnabled = false
      BswMSdEnabled = false
      BswMJ1939DcmEnabled = false
      BswMModeCheck = true
      BswMPduREnabled = false
      BswMRuleControlEnabled = false
      BswMWdgMEnabled = false
      BswMUserIncludeFiles: BswMUserIncludeFile=main.h
      BswMCommonData
      BswMGeneration:
        BswMOutOfBoundsWriteSanitizer = false
        BswMOutOfBoundsReadSanitizer = false
        BswMReduceConstantData2Define = true
        BswMReduceDataByStreaming = false
        BswMBoolDataInArrayOfStructStrategy = BITMASKING
        BswMInterfacesForDeactivatedData = false
    BswMConfig
      BswMArbitration
        BswMRule_CAN_FULL_COMM (BswMRule):
          BswMNestedExecutionOnly = false
          BswMRuleInitState = BSWM_FALSE
          BswMRuleId = 0
          BswMRuleExpressionRef = BswMLogicalExpression
          BswMRuleTrueActionList = BswMActionList_CAN_FULL_COMM_TRUE
          BswMRuleFalseActionList = BswMActionList_CAN_FULL_COMM_FALSE
        CanSMInd_CAN00_f26020e5 (BswMModeRequestPort): BswMRequestProcessing=BSWM_IMMEDIATE, BswMArbitrateOnInit=false
          BswMModeRequestSource
            BswMCanSMIndication: BswMCanSMChannelRef=CAN00_f26020e5
          BswMModeInitValue
            BswMBswModeInitValue: BswMBswModeInitValueMode=CANSM_BSWM_NO_COMMUNICATION
        CanSMInd_CAN00_f26020e5_BSWM_EQUALS_CANSM_BSWM_FULL_COMMUNICATION (BswMModeCondition): BswMConditionType=BSWM_EQUALS, BswMConditionMode=CanSMInd_CAN00_f26020e5
          BswMConditionValue
            BswMBswMode: BswMBswRequestedMode=CANSM_BSWM_FULL_COMMUNICATION
        BswMLogicalExpression: BswMLogicalOperator=BSWM_AND, BswMArgumentRef=CanSMInd_CAN00_f26020e5_BSWM_EQUALS_CANSM_BSWM_FULL_COMMUNICATION
      BswMModeControl: BswMInitActionListRef=INIT_AL_Initialize
        INIT_AL_Initialize (BswMActionList): BswMActionListExecution=BSWM_CONDITION
          14 x BswMActionListItem, all with BswMAbortOnFail=false:
            INIT_Action_Fls_Init: BswMActionListItemIndex=0, BswMActionListItemRef=BswMModeControl/INIT_Action_Fls_Init
            INIT_Action_Fee_Init: BswMActionListItemIndex=1, BswMActionListItemRef=BswMModeControl/INIT_Action_Fee_Init
            INIT_Action_NvM_Init: BswMActionListItemIndex=2, BswMActionListItemRef=BswMModeControl/INIT_Action_NvM_Init
            INIT_Action_NvMReadAll: BswMActionListItemIndex=3, BswMActionListItemRef=BswMModeControl/INIT_Action_NvMReadAll
            INIT_Action_Nm_Init: BswMActionListItemIndex=4, BswMActionListItemRef=BswMModeControl/INIT_Action_Nm_Init
            INIT_Action_Can_Init: BswMActionListItemIndex=5, BswMActionListItemRef=BswMModeControl/INIT_Action_Can_Init
            INIT_Action_CanIf_Init: BswMActionListItemIndex=6, BswMActionListItemRef=BswMModeControl/INIT_Action_CanIf_Init
            INIT_Action_CanNm_Init: BswMActionListItemIndex=7, BswMActionListItemRef=BswMModeControl/INIT_Action_CanNm_Init
            INIT_Action_CanSM_Init: BswMActionListItemIndex=8, BswMActionListItemRef=BswMModeControl/INIT_Action_CanSM_Init
            INIT_Action_PduR_Init: BswMActionListItemIndex=9, BswMActionListItemRef=BswMModeControl/INIT_Action_PduR_Init
            INIT_Action_Com_Init: BswMActionListItemIndex=10, BswMActionListItemRef=BswMModeControl/INIT_Action_Com_Init
            INIT_Action_ComM_Init: BswMActionListItemIndex=11, BswMActionListItemRef=BswMModeControl/INIT_Action_ComM_Init
            INIT_Action_Dem_Init: BswMActionListItemIndex=12, BswMActionListItemRef=BswMModeControl/INIT_Action_Dem_Init
            INIT_Action_RteStart: BswMActionListItemIndex=13, BswMActionListItemRef=BswMModeControl/INIT_Action_RteStart
        15 x BswMAction:
          INIT_Action_Fls_Init
            BswMAvailableActions
              BswMUserCallout: BswMUserCalloutFunction=Fls_Init(&FlsConfigSet), BswMCreateCallout=false, BswMUserIncludeFile=Fls.h
          INIT_Action_Fee_Init
            BswMAvailableActions
              BswMUserCallout: BswMUserCalloutFunction=Fee_Init(), BswMCreateCallout=false, BswMUserIncludeFile=Fee.h
          INIT_Action_NvM_Init
            BswMAvailableActions
              BswMUserCallout: BswMUserCalloutFunction=NvM_Init(), BswMCreateCallout=false, BswMUserIncludeFile=NvM.h
          INIT_Action_NvMReadAll
            BswMAvailableActions
              BswMUserCallout: BswMUserCalloutFunction=BswM_INIT_NvMReadAll(), BswMCreateCallout=true
          INIT_Action_Nm_Init
            BswMAvailableActions
              BswMUserCallout: BswMUserCalloutFunction=Nm_Init(), BswMCreateCallout=false, BswMUserIncludeFile=Nm.h
          INIT_Action_Can_Init
            BswMAvailableActions
              BswMUserCallout: BswMUserCalloutFunction=Can_Init(NULL_PTR), BswMCreateCallout=false, BswMUserIncludeFile=Can.h
          INIT_Action_CanIf_Init
            BswMAvailableActions
              BswMUserCallout: BswMUserCalloutFunction=CanIf_Init(NULL_PTR), BswMCreateCallout=false, BswMUserIncludeFile=CanIf.h
          INIT_Action_CanNm_Init
            BswMAvailableActions
              BswMUserCallout: BswMUserCalloutFunction=CanNm_Init(NULL_PTR), BswMCreateCallout=false, BswMUserIncludeFile=CanNm.h
          INIT_Action_CanSM_Init
            BswMAvailableActions
              BswMUserCallout: BswMUserCalloutFunction=CanSM_Init(&CanSMConfiguration), BswMCreateCallout=false, BswMUserIncludeFile=CanSM_EcuM.h
          INIT_Action_PduR_Init
            BswMAvailableActions
              BswMUserCallout: BswMUserCalloutFunction=PduR_Init(NULL_PTR), BswMCreateCallout=false, BswMUserIncludeFile=PduR.h
          INIT_Action_Com_Init
            BswMAvailableActions
              BswMUserCallout: BswMUserCalloutFunction=Com_Init(NULL_PTR), BswMCreateCallout=false, BswMUserIncludeFile=Com.h
          INIT_Action_ComM_Init
            BswMAvailableActions
              BswMUserCallout: BswMUserCalloutFunction=ComM_Init(), BswMCreateCallout=false, BswMUserIncludeFile=ComM.h
          INIT_Action_Dem_Init
            BswMAvailableActions
              BswMUserCallout: BswMUserCalloutFunction=Dem_Init(), BswMCreateCallout=false, BswMUserIncludeFile=Dem.h
          INIT_Action_RteStart
            BswMAvailableActions
              BswMUserCallout: BswMUserCalloutFunction=RteStart(), BswMCreateCallout=true
          Com_IpduGroupControl_BswMActionList_CAN_FULL_COMM
            BswMAvailableActions
              BswMPduGroupSwitch: BswMPduGroupSwitchReinit=false, BswMEnabledPduGroupRef=MyECU_oCAN00_Tx_fcef2243, BswMEnabledPduGroupRef=MyECU_oCAN00_Rx_fcef2243
        BswMActionList_CAN_FULL_COMM_TRUE (BswMActionList): BswMActionListExecution=BSWM_TRIGGER
          Com_IpduGroupControl_BswMActionList_CAN_FULL_COMM (BswMActionListItem): BswMAbortOnFail=false, BswMActionListItemIndex=0, BswMActionListItemRef=BswMModeControl/Com_IpduGroupControl_BswMActionList_CAN_FULL_COMM
        Com_IpduGroupControl_BswMActionList_CAN_NO_COMM (BswMAction)
          BswMAvailableActions
            BswMPduGroupSwitch: BswMPduGroupSwitchReinit=false, BswMDisabledPduGroupRef=MyECU_oCAN00_Rx_fcef2243, BswMDisabledPduGroupRef=MyECU_oCAN00_Tx_fcef2243
        BswMActionList_CAN_FULL_COMM_FALSE (BswMActionList): BswMActionListExecution=BSWM_TRIGGER
          Com_IpduGroupControl_BswMActionList_CAN_NO_COMM (BswMActionListItem): BswMAbortOnFail=false, BswMActionListItemIndex=0, BswMActionListItemRef=BswMModeControl/Com_IpduGroupControl_BswMActionList_CAN_NO_COMM
  module config Dem: implementation-config-variant=VARIANT-PRE-COMPILE, module-description=Dem_Impl
    DemConfigSet
      9 x DemEventParameter, all with DemEventKind=DEM_EVENT_KIND_BSW, DemMaxNumberFreezeFrameRecords=0, DemEventAvailable=true, DemEventTimeSeries=DEM_TIMESERIES_SNAPSHOT_NONE, DemEventAvailableInVariant=true, DemEventLatchTestFailed=false:
        AutoCreatedDemEvent_ECUM_E_CONFIGURATION_DATA_INCONSISTENT: DemEventId=1
          DemEventClass:
            DemAgingAllowed = false
            DemConsiderPtoStatus = false
            DemEventDestination = DEM_DTC_ORIGIN_PRIMARY_MEMORY
            DemEventOBDReadinessGroup = DEM_OBD_RDY_NONE
            DemEventPriority = 2
            DemFFPrestorageSupported = false
            DemOperationCycleRef = PowerCycle
            DemDebounceAlgorithmClass
              DemDebounceCounterBased:
                DemDebounceCounterDecrementStepSize = 1
                DemDebounceCounterFailedThreshold = 127
                DemDebounceCounterIncrementStepSize = 1
                DemDebounceCounterJumpDown = true
                DemDebounceCounterJumpDownValue = 0
                DemDebounceCounterJumpUp = true
                DemDebounceCounterJumpUpValue = 0
                DemDebounceCounterPassedThreshold = -128
                DemDebounceCounterStorage = false
                DemDebounceBehavior = DEM_DEBOUNCE_FREEZE
                DemDebounceContinuous = false
        AutoCreatedDemEvent_ECUM_E_RAM_CHECK_FAILED: DemEventId=2
          DemEventClass:
            DemAgingAllowed = false
            DemConsiderPtoStatus = false
            DemEventDestination = DEM_DTC_ORIGIN_PRIMARY_MEMORY
            DemEventOBDReadinessGroup = DEM_OBD_RDY_NONE
            DemEventPriority = 2
            DemFFPrestorageSupported = false
            DemOperationCycleRef = PowerCycle
            DemDebounceAlgorithmClass
              DemDebounceCounterBased:
                DemDebounceCounterDecrementStepSize = 1
                DemDebounceCounterFailedThreshold = 127
                DemDebounceCounterIncrementStepSize = 1
                DemDebounceCounterJumpDown = true
                DemDebounceCounterJumpDownValue = 0
                DemDebounceCounterJumpUp = true
                DemDebounceCounterJumpUpValue = 0
                DemDebounceCounterPassedThreshold = -128
                DemDebounceCounterStorage = false
                DemDebounceBehavior = DEM_DEBOUNCE_FREEZE
                DemDebounceContinuous = false
        AutoCreatedDemEvent_NVM_E_INTEGRITY_FAILED: DemEventId=3
          DemEventClass:
            DemAgingAllowed = false
            DemConsiderPtoStatus = false
            DemEventDestination = DEM_DTC_ORIGIN_PRIMARY_MEMORY
            DemEventOBDReadinessGroup = DEM_OBD_RDY_NONE
            DemEventPriority = 2
            DemFFPrestorageSupported = false
            DemOperationCycleRef = PowerCycle
            DemDebounceAlgorithmClass
              DemDebounceCounterBased:
                DemDebounceCounterDecrementStepSize = 1
                DemDebounceCounterFailedThreshold = 127
                DemDebounceCounterIncrementStepSize = 1
                DemDebounceCounterJumpDown = true
                DemDebounceCounterJumpDownValue = 0
                DemDebounceCounterJumpUp = true
                DemDebounceCounterJumpUpValue = 0
                DemDebounceCounterPassedThreshold = -128
                DemDebounceCounterStorage = false
                DemDebounceBehavior = DEM_DEBOUNCE_FREEZE
                DemDebounceContinuous = false
        AutoCreatedDemEvent_NVM_E_LOSS_OF_REDUNDANCY: DemEventId=4
          DemEventClass:
            DemAgingAllowed = false
            DemConsiderPtoStatus = false
            DemEventDestination = DEM_DTC_ORIGIN_PRIMARY_MEMORY
            DemEventOBDReadinessGroup = DEM_OBD_RDY_NONE
            DemEventPriority = 2
            DemFFPrestorageSupported = false
            DemOperationCycleRef = PowerCycle
            DemDebounceAlgorithmClass
              DemDebounceCounterBased:
                DemDebounceCounterDecrementStepSize = 1
                DemDebounceCounterFailedThreshold = 127
                DemDebounceCounterIncrementStepSize = 1
                DemDebounceCounterJumpDown = true
                DemDebounceCounterJumpDownValue = 0
                DemDebounceCounterJumpUp = true
                DemDebounceCounterJumpUpValue = 0
                DemDebounceCounterPassedThreshold = -128
                DemDebounceCounterStorage = false
                DemDebounceBehavior = DEM_DEBOUNCE_FREEZE
                DemDebounceContinuous = false
        AutoCreatedDemEvent_NVM_E_QUEUE_OVERFLOW: DemEventId=5
          DemEventClass:
            DemAgingAllowed = false
            DemConsiderPtoStatus = false
            DemEventDestination = DEM_DTC_ORIGIN_PRIMARY_MEMORY
            DemEventOBDReadinessGroup = DEM_OBD_RDY_NONE
            DemEventPriority = 2
            DemFFPrestorageSupported = false
            DemOperationCycleRef = PowerCycle
            DemDebounceAlgorithmClass
              DemDebounceCounterBased:
                DemDebounceCounterDecrementStepSize = 1
                DemDebounceCounterFailedThreshold = 127
                DemDebounceCounterIncrementStepSize = 1
                DemDebounceCounterJumpDown = true
                DemDebounceCounterJumpDownValue = 0
                DemDebounceCounterJumpUp = true
                DemDebounceCounterJumpUpValue = 0
                DemDebounceCounterPassedThreshold = -128
                DemDebounceCounterStorage = false
                DemDebounceBehavior = DEM_DEBOUNCE_FREEZE
                DemDebounceContinuous = false
        AutoCreatedDemEvent_NVM_E_REQ_FAILED: DemEventId=6
          DemEventClass:
            DemAgingAllowed = false
            DemConsiderPtoStatus = false
            DemEventDestination = DEM_DTC_ORIGIN_PRIMARY_MEMORY
            DemEventOBDReadinessGroup = DEM_OBD_RDY_NONE
            DemEventPriority = 2
            DemFFPrestorageSupported = false
            DemOperationCycleRef = PowerCycle
            DemDebounceAlgorithmClass
              DemDebounceCounterBased:
                DemDebounceCounterDecrementStepSize = 1
                DemDebounceCounterFailedThreshold = 127
                DemDebounceCounterIncrementStepSize = 1
                DemDebounceCounterJumpDown = true
                DemDebounceCounterJumpDownValue = 0
                DemDebounceCounterJumpUp = true
                DemDebounceCounterJumpUpValue = 0
                DemDebounceCounterPassedThreshold = -128
                DemDebounceBehavior = DEM_DEBOUNCE_FREEZE
                DemDebounceCounterStorage = false
                DemDebounceContinuous = false
        AutoCreatedDemEvent_NVM_E_VERIFY_FAILED: DemEventId=7
          DemEventClass:
            DemAgingAllowed = false
            DemConsiderPtoStatus = false
            DemEventDestination = DEM_DTC_ORIGIN_PRIMARY_MEMORY
            DemEventOBDReadinessGroup = DEM_OBD_RDY_NONE
            DemEventPriority = 2
            DemFFPrestorageSupported = false
            DemOperationCycleRef = PowerCycle
            DemDebounceAlgorithmClass
              DemDebounceCounterBased:
                DemDebounceCounterDecrementStepSize = 1
                DemDebounceCounterFailedThreshold = 127
                DemDebounceCounterIncrementStepSize = 1
                DemDebounceCounterJumpDown = true
                DemDebounceCounterJumpDownValue = 0
                DemDebounceCounterJumpUp = true
                DemDebounceCounterJumpUpValue = 0
                DemDebounceCounterPassedThreshold = -128
                DemDebounceCounterStorage = false
                DemDebounceBehavior = DEM_DEBOUNCE_FREEZE
                DemDebounceContinuous = false
        AutoCreatedDemEvent_NVM_E_WRITE_PROTECTED: DemEventId=8
          DemEventClass:
            DemAgingAllowed = false
            DemConsiderPtoStatus = false
            DemEventDestination = DEM_DTC_ORIGIN_PRIMARY_MEMORY
            DemEventOBDReadinessGroup = DEM_OBD_RDY_NONE
            DemEventPriority = 2
            DemFFPrestorageSupported = false
            DemOperationCycleRef = PowerCycle
            DemDebounceAlgorithmClass
              DemDebounceCounterBased:
                DemDebounceCounterDecrementStepSize = 1
                DemDebounceCounterFailedThreshold = 127
                DemDebounceCounterIncrementStepSize = 1
                DemDebounceCounterJumpDown = true
                DemDebounceCounterJumpDownValue = 0
                DemDebounceCounterJumpUp = true
                DemDebounceCounterJumpUpValue = 0
                DemDebounceCounterPassedThreshold = -128
                DemDebounceCounterStorage = false
                DemDebounceBehavior = DEM_DEBOUNCE_FREEZE
                DemDebounceContinuous = false
        AutoCreatedDemEvent_NVM_E_WRONG_BLOCK_ID: DemEventId=9
          DemEventClass:
            DemAgingAllowed = false
            DemConsiderPtoStatus = false
            DemEventDestination = DEM_DTC_ORIGIN_PRIMARY_MEMORY
            DemEventOBDReadinessGroup = DEM_OBD_RDY_NONE
            DemEventPriority = 2
            DemFFPrestorageSupported = false
            DemOperationCycleRef = PowerCycle
            DemDebounceAlgorithmClass
              DemDebounceCounterBased:
                DemDebounceCounterDecrementStepSize = 1
                DemDebounceCounterFailedThreshold = 127
                DemDebounceCounterIncrementStepSize = 1
                DemDebounceCounterJumpDown = true
                DemDebounceCounterJumpDownValue = 0
                DemDebounceCounterJumpUp = true
                DemDebounceCounterJumpUpValue = 0
                DemDebounceCounterPassedThreshold = -128
                DemDebounceCounterStorage = false
                DemDebounceBehavior = DEM_DEBOUNCE_FREEZE
                DemDebounceContinuous = false
      DtcClass_DTC_0x000002 (DemDTCClass): DemDTCSeverity=DEM_DTC_SEV_NO_SEVERITY, DemUdsDTC=2, DemImmediateNvStorage=false, DemDTCFunctionalUnit=255
    DemGeneral:
      DemAgingCycleCounterProcessing = DEM_PROCESS_AGINGCTR_INTERN
      DemDebounceCounterBasedSupport = true
      DemDtcStatusAvailabilityMask = 255
      DemMaxNumberEventEntryMirror = 0
      DemPTOSupport = false
      DemTypeOfFreezeFrameRecordNumeration = DEM_FF_RECNUM_CALCULATED
      DemEventMemoryEntryStorageTrigger = DEM_STORAGE_ON_TEST_FAILED
      DemGeneralInterfaceSupport = false
      DemAvailabilitySupport = DEM_EVENT_AVAILABILITY
      DemClearDTCLimitation = DEM_ALL_SUPPORTED_DTCS
      DemDataElementDefaultEndianness = LITTLE_ENDIAN
      DemAgingRequieresTestedCycle = false
      DemBswErrorBufferSize = 0
      DemClearDTCBehavior = DEM_CLRRESP_VOLATILE
      DemDebounceTimeBasedSupport = false
      DemDevErrorDetect = true
      DemEnableConditionSupport = false
      DemEventCombinationSupport = DEM_EVCOMB_DISABLED
      DemEventDisplacementStrategy = DEM_DISPLACEMENT_NONE
      DemMaxNumberEventEntryPermanent = 0
      DemMaxNumberEventEntryPrimary = 8
      DemMaxNumberEventEntrySecondary = 0
      DemMaxNumberPrestoredFF = 0
      DemOBDSupport = DEM_OBD_NO_OBD_SUPPORT
      DemOccurrenceCounterProcessing = DEM_PROCESS_OCCCTR_TF
      DemOperationCycleStatusStorage = false
      DemResetConfirmedBitOnOverflow = false
      DemStatusBitHandlingTestFailedSinceLastClear = DEM_STATUS_BIT_NORMAL
      DemStatusBitStorageTestFailed = true
      DemStorageConditionSupport = false
      DemSuppressionSupport = DEM_NO_SUPPRESSION
      DemTaskTime = 0.01
      DemTriggerDcmReports = false
      DemTriggerDltReports = false
      DemTriggerFiMReports = false
      DemTriggerMonitorInitBeforeClearOk = true
      DemTypeOfDTCSupported = DEM_DTC_TRANSLATION_ISO14229_1
      DemVersionInfoApi = false
      DemUseRte = true
      DemGeneralDiagnosticInfoSupport = true
      DemPendingDtcProcessing = DEM_PROCESS_PDTC_ALL_DTC
      DemWarningIndicatorRequestedProcessing = DEM_PROCESS_WIR_ALL_DTC
      DemMaxNumberEventEntryOBDFreezeFrame = 0
      DemAgingRetainEnvironmentalData = false
      DemEventDisplacementFallbackStrategy = DEM_FALLBACK_DISCARD_NEW_EVENT
      DemJ1939Support = false
      DemUseMemcopyMacros = false
      DemOperationCycleProcessing = DEM_PROCESS_OPCYC_STATE
      DemAgingBehavior = DEM_AGING_TYPE_1
      DemExtendedDataCapture = DEM_TRIGGER_EVENT_MEMORY_STORAGE
      DemFreezeFrameCapture = DEM_TRIGGER_EVENT_MEMORY_STORAGE
      DemMaxNumberTimeSeriesSnapshots = 0
      DemAgingAfterHealing = DEM_AGING_WHILE_HEALING
      DemAgingCounterBehavior = DEM_AGING_COUNT_ALWAYS
      DemAgingCounterReporting = DEM_AGING_NORMAL_REPORTING
      DemAvailabilityStorage = false
      DemBswApiVersion = DEM_BSW_API_4_XX_XX
      DemBswApiVersionFiM = DEM_BSW_API_4_XX_XX
      DemBswApiVersionNvM = DEM_BSW_API_4_XX_XX
      DemCompiledPostbuildCrc = 1681153567
      DemCompiledPostbuildCrcMode = DEM_POSTBUILD_CRC_AUTOMATIC
      DemNvSynchronizeSupport = false
      DemResetDebounceBehavior = DEM_RESET_DEBOUNCE_ON_DISABLE_ENABLE_CONDITIONS
      DemResetTestFailedOnOperationCycleStart = false
      DemRetryStorageSupport = false
      DemTriggerMonitorInitForEnableConditions = false
      DemUserControlledWirBehavior = DEM_DISABLED_DURING_CONTROLDTCSETTING
      10 x DemNvRamBlockId:
        Dem_AdminData: DemNvRamBlockIdType=DEM_NVBLOCK_ADMIN, DemNvRamBlockIdRef=DemAdminDataBlock
        Dem_StatusData: DemNvRamBlockIdType=DEM_NVBLOCK_STATUS, DemNvRamBlockIdRef=DemStatusDataBlock
        Dem_PrimaryEntry{0..7}: DemNvRamBlockIdType=DEM_NVBLOCK_PRIMARY, DemNvRamBlockIdIndex={0..7}, DemNvRamBlockIdRef=DemPrimaryDataBlock{0..7}
      PowerCycle (DemOperationCycle): DemOperationCycleType=DEM_OPCYC_POWER, DemOperationCycleAutomaticEnd=false, DemOperationCycleAutostart=false
      IgnitionCycle (DemOperationCycle): DemOperationCycleType=DEM_OPCYC_IGNITION, DemOperationCycleAutomaticEnd=false, DemOperationCycleAutostart=false
      DemPostbuild: DemMaxSizeFreezeFrame=0, DemEventAvailableDefaultSupport=true, DemMaxNumberDtr=0
